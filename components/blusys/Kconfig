## examples/lcd_st7735_basic/main/Kconfig.projbuild
```kconfig
menu "Blusys LCD ST7735 Basic Example"

config BLUSYS_LCD_ST7735_SPI_BUS
    int "SPI bus"
    range 0 1
    default 0

config BLUSYS_LCD_ST7735_SCLK_PIN
    int "SCLK GPIO pin"
    default 18 if IDF_TARGET_ESP32
    default 4 if IDF_TARGET_ESP32C3
    default 12 if IDF_TARGET_ESP32S3

config BLUSYS_LCD_ST7735_MOSI_PIN
    int "MOSI GPIO pin"
    default 23 if IDF_TARGET_ESP32
    default 6 if IDF_TARGET_ESP32C3
    default 11 if IDF_TARGET_ESP32S3

config BLUSYS_LCD_ST7735_CS_PIN
    int "CS GPIO pin"
    default 5 if IDF_TARGET_ESP32
    default 7 if IDF_TARGET_ESP32C3
    default 10 if IDF_TARGET_ESP32S3

config BLUSYS_LCD_ST7735_DC_PIN
    int "DC GPIO pin"
    default 2 if IDF_TARGET_ESP32
    default 3 if IDF_TARGET_ESP32C3
    default 13 if IDF_TARGET_ESP32S3

config BLUSYS_LCD_ST7735_RST_PIN
    int "RST GPIO pin (-1 if not used)"
    default -1

config BLUSYS_LCD_ST7735_BL_PIN
    int "Backlight GPIO pin (-1 if not used)"
    default -1

config BLUSYS_LCD_ST7735_PCLK_HZ
    int "SPI pixel clock Hz"
    default 16000000

config BLUSYS_LCD_ST7735_X_OFFSET
    int "ST7735 X offset"
    default 2

config BLUSYS_LCD_ST7735_Y_OFFSET
    int "ST7735 Y offset"
    default 1

config BLUSYS_LCD_ST7735_SWAP_XY
    bool "Swap X/Y"
    default y

config BLUSYS_LCD_ST7735_MIRROR_X
    bool "Mirror X"
    default y

config BLUSYS_LCD_ST7735_MIRROR_Y
    bool "Mirror Y"
    default n

config BLUSYS_LCD_ST7735_INVERT_COLOR
    bool "Invert colors"
    default n

endmenu
```

## examples/led_strip_basic/main/Kconfig.projbuild
```kconfig
menu "Blusys LED Strip Basic Example"

config BLUSYS_LED_STRIP_PIN
    int "LED strip data GPIO pin"
    range 0 48
    default 18 if IDF_TARGET_ESP32
    default 8  if IDF_TARGET_ESP32C3
    default 48 if IDF_TARGET_ESP32S3
    help
        GPIO pin connected to the DIN of the WS2812B LED strip.
        Use a board-safe output GPIO; change via menuconfig if needed.

config BLUSYS_LED_STRIP_LED_COUNT
    int "Number of LEDs in the strip"
    range 1 300
    default 8
    help
        Total number of WS2812B LEDs on the strip.

endmenu
```

## examples/oled_encoder_basic/sdkconfig.defaults
```kconfig
CONFIG_LV_OS_FREERTOS=y
CONFIG_LV_COLOR_DEPTH_16=y
CONFIG_LV_FONT_MONTSERRAT_20=y
```

## examples/one_wire_basic/main/Kconfig.projbuild
```kconfig
menu "Blusys 1-Wire Basic Example"

config BLUSYS_ONE_WIRE_BASIC_PIN
    int "1-Wire bus GPIO pin"
    range 0 48
    default 4 if IDF_TARGET_ESP32
    default 3 if IDF_TARGET_ESP32C3
    default 4 if IDF_TARGET_ESP32S3
    help
        GPIO connected to the 1-Wire bus data line.
        Connect a 4.7 kΩ pull-up resistor from this pin to 3.3 V.
        All standard output-capable GPIOs support the required open-drain mode.

endmenu
```

## examples/ota_basic/main/Kconfig.projbuild
```kconfig
menu "OTA Basic Example"

    config WIFI_SSID
        string "WiFi SSID"
        default "myssid"
        help
            SSID of the AP to connect to.

    config WIFI_PASSWORD
        string "WiFi Password"
        default "mypassword"
        help
            Password of the AP. Leave empty for open networks.

    config WIFI_CONNECT_TIMEOUT_MS
        int "WiFi connect timeout (ms)"
        default 10000
        range 1000 60000
        help
            Maximum time to wait for a WiFi connection in milliseconds.

    config OTA_FIRMWARE_URL
        string "Firmware URL"
        default "http://192.168.1.100:8080/firmware.bin"
        help
            URL of the firmware binary to download. Supports HTTP and HTTPS.
            For HTTPS, set OTA_CERT_PEM or the server must use a trusted CA.

endmenu
```

## examples/pcnt_basic/main/Kconfig.projbuild
```kconfig
menu "Blusys PCNT Basic Example"

config BLUSYS_PCNT_BASIC_PWM_PIN
    int "PWM output GPIO pin"
    range 0 48
    default 4 if IDF_TARGET_ESP32
    default 3 if IDF_TARGET_ESP32C3
    default 4 if IDF_TARGET_ESP32S3
    help
        Select a board-safe PWM-capable output GPIO for the pulse source.

config BLUSYS_PCNT_BASIC_INPUT_PIN
    int "PCNT input GPIO pin"
    range 0 48
    default 5 if IDF_TARGET_ESP32
    default 4 if IDF_TARGET_ESP32C3
    default 5 if IDF_TARGET_ESP32S3
    help
        Select a GPIO to receive the looped-back pulse input.

endmenu
```
