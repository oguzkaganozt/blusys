## components/blusys_framework/Kconfig
```kconfig
menu "Blusys framework"

    menu "Display profiles"

        choice BLUSYS_DASHBOARD_DISPLAY_PROFILE
            prompt "Dashboard-class display (device)"
            default BLUSYS_DASHBOARD_DISPLAY_PROFILE_ILI9341
            help
                Used by surface_gateway, surface_ops_panel, interactive_dashboard, and mqtt_dashboard.
                Pick a SPI panel for hardware (including compact ST7735 on e.g. ESP32-C3), or QEMU
                virtual RGB for Espressif QEMU with --graphics (ESP32-S3 / ESP32-C3 only; see
                interactive_dashboard/sdkconfig.qemu).

            config BLUSYS_DASHBOARD_DISPLAY_PROFILE_ILI9341
                bool "ILI9341 320x240 landscape (SPI)"

            config BLUSYS_DASHBOARD_DISPLAY_PROFILE_ILI9488
                bool "ILI9488 480x320 landscape (SPI)"

            config BLUSYS_DASHBOARD_DISPLAY_PROFILE_ST7735
                bool "ST7735 160x128 landscape (SPI)"

            config BLUSYS_DASHBOARD_DISPLAY_PROFILE_SSD1306
                bool "SSD1306 128x64 I2C OLED (monochrome)"

            config BLUSYS_DASHBOARD_LCD_QEMU_RGB
                bool "QEMU virtual RGB 320x240 (esp_lcd_qemu_rgb, idf.py qemu --graphics)"
                depends on IDF_TARGET_ESP32S3 || IDF_TARGET_ESP32C3

        endchoice

        choice BLUSYS_INTERACTIVE_DISPLAY_PROFILE
            prompt "Handheld interactive SPI display"
            default BLUSYS_INTERACTIVE_DISPLAY_PROFILE_ST7735
            help
                Used by the handheld_starter quickstart. Host SDL window size follows
                host CMake when simulating the selected profile.

            config BLUSYS_INTERACTIVE_DISPLAY_PROFILE_ST7735
                bool "ST7735 160x128 (canonical)"

            config BLUSYS_INTERACTIVE_DISPLAY_PROFILE_ST7789
                bool "ST7789 320x240 landscape"

        endchoice

    endmenu

endmenu
```

## examples/adc_basic/main/Kconfig.projbuild
```kconfig
menu "Blusys ADC Basic Example"

config BLUSYS_ADC_BASIC_PIN
    int "ADC GPIO pin"
    range 0 48
    default 4 if IDF_TARGET_ESP32C3
    default 4 if IDF_TARGET_ESP32S3
    help
        Select a board-safe ADC1 GPIO for this example.

config BLUSYS_ADC_BASIC_ATTEN_DB_12
    bool "Use 12 dB attenuation"
    default y
    help
        Disable this only if you specifically want 0 dB mode for lower input voltages.

endmenu
```

## examples/bluetooth_basic/main/Kconfig.projbuild
```kconfig
menu "Bluetooth Basic Example"

    config BT_DEVICE_NAME
        string "BLE Device Name"
        default "blusys-device"
        help
            The GAP device name broadcast in BLE advertising data.
            Maximum 29 bytes (advertising payload is 31 bytes; name AD structure
            uses 2 bytes of overhead).

    choice BT_MODE
        prompt "BLE Operating Mode"
        default BT_MODE_ADVERTISE
        help
            Select whether the device should advertise itself (peripheral role)
            or scan for nearby BLE devices (central role).

        config BT_MODE_ADVERTISE
            bool "Advertise (peripheral)"
        config BT_MODE_SCAN
            bool "Scan (central)"
    endchoice

endmenu
```

## examples/buzzer_basic/main/Kconfig.projbuild
```kconfig
menu "Blusys Buzzer Basic Example"

config BLUSYS_BUZZER_BASIC_PIN
    int "Buzzer GPIO pin"
    range 0 48
    default 18 if IDF_TARGET_ESP32
    default 3  if IDF_TARGET_ESP32C3
    default 8  if IDF_TARGET_ESP32S3
    help
        GPIO pin connected to the passive piezo buzzer signal pin.
        Connect the other buzzer terminal to GND.

config BLUSYS_BUZZER_BASIC_DUTY_PERMILLE
    int "PWM duty cycle (permille, 1-1000)"
    range 1 1000
    default 500
    help
        Duty cycle for the PWM signal driving the buzzer.
        500 (50% square wave) gives maximum volume for a passive piezo.
        Lower values reduce volume.

endmenu
```

## examples/concurrency_spi/main/Kconfig.projbuild
```kconfig
menu "Blusys Concurrency SPI Test"

config BLUSYS_CONCURRENCY_SPI_BUS
    int "SPI bus"
    range 0 1
    default 0
    help
        Select the SPI bus used by this concurrency test.

config BLUSYS_CONCURRENCY_SPI_SCLK_PIN
    int "SCLK GPIO pin"
    range 0 48
    default 18 if IDF_TARGET_ESP32
    default 4 if IDF_TARGET_ESP32C3
    default 12 if IDF_TARGET_ESP32S3
    help
        Select a board-safe SPI clock GPIO for this test.

config BLUSYS_CONCURRENCY_SPI_MOSI_PIN
    int "MOSI GPIO pin"
    range 0 48
    default 23 if IDF_TARGET_ESP32
    default 6 if IDF_TARGET_ESP32C3
    default 1 if IDF_TARGET_ESP32S3
    help
        Select a board-safe SPI MOSI GPIO for this test.

config BLUSYS_CONCURRENCY_SPI_MISO_PIN
    int "MISO GPIO pin"
    range 0 48
    default 19 if IDF_TARGET_ESP32
    default 5 if IDF_TARGET_ESP32C3
    default 2 if IDF_TARGET_ESP32S3
    help
        Select a board-safe SPI MISO GPIO for this test.

config BLUSYS_CONCURRENCY_SPI_CS_PIN
    int "CS GPIO pin"
    range 0 48
    default 25 if IDF_TARGET_ESP32
    default 7 if IDF_TARGET_ESP32C3
    default 10 if IDF_TARGET_ESP32S3
    help
        Select a board-safe SPI chip-select GPIO for this test.

endmenu
```

## examples/concurrency_uart/main/Kconfig.projbuild
```kconfig
menu "Blusys Concurrency UART Test"

config BLUSYS_CONCURRENCY_UART_PORT
    int "UART port"
    range 0 2
    default 1
    help
        Select the UART port used by this concurrency test.

config BLUSYS_CONCURRENCY_UART_TX_PIN
    int "TX GPIO pin"
    range 0 48
    default 17 if IDF_TARGET_ESP32
    default 21 if IDF_TARGET_ESP32C3
    default 1 if IDF_TARGET_ESP32S3
    help
        Select a board-safe TX output GPIO for this test.

config BLUSYS_CONCURRENCY_UART_RX_PIN
    int "RX GPIO pin"
    range 0 48
    default 16 if IDF_TARGET_ESP32
    default 20 if IDF_TARGET_ESP32C3
    default 2 if IDF_TARGET_ESP32S3
    help
        Select a board-safe RX input GPIO for this test.

endmenu
```

## examples/encoder_basic/main/Kconfig.projbuild
```kconfig
menu "Blusys Encoder Basic Example"

config BLUSYS_ENCODER_BASIC_CLK_PIN
    int "Encoder CLK (A) GPIO pin"
    range 0 48
    default 16 if IDF_TARGET_ESP32
    default 2 if IDF_TARGET_ESP32C3
    default 5 if IDF_TARGET_ESP32S3

config BLUSYS_ENCODER_BASIC_DT_PIN
    int "Encoder DT (B) GPIO pin"
    range 0 48
    default 17 if IDF_TARGET_ESP32
    default 3 if IDF_TARGET_ESP32C3
    default 6 if IDF_TARGET_ESP32S3

config BLUSYS_ENCODER_BASIC_SW_PIN
    int "Encoder SW (button) GPIO pin (-1 to disable)"
    range -1 48
    default 18 if IDF_TARGET_ESP32
    default 4 if IDF_TARGET_ESP32C3
    default 7 if IDF_TARGET_ESP32S3

endmenu
```

## examples/gpio_expander_basic/main/Kconfig.projbuild
```kconfig
menu "Blusys GPIO Expander Basic Example"

choice BLUSYS_GPIO_EXPANDER_BASIC_IC
    prompt "GPIO expander IC"
    default BLUSYS_GPIO_EXPANDER_BASIC_IC_PCF8574
    help
        Select the GPIO expander IC connected to the board.

config BLUSYS_GPIO_EXPANDER_BASIC_IC_PCF8574
    bool "PCF8574 (8-bit I2C, address 0x20–0x27)"
config BLUSYS_GPIO_EXPANDER_BASIC_IC_PCF8574A
    bool "PCF8574A (8-bit I2C, address 0x38–0x3F)"
config BLUSYS_GPIO_EXPANDER_BASIC_IC_MCP23017
    bool "MCP23017 (16-bit I2C, address 0x20–0x27)"
config BLUSYS_GPIO_EXPANDER_BASIC_IC_MCP23S17
    bool "MCP23S17 (16-bit SPI, hw_addr 0–7)"
endchoice

# ── I2C settings (PCF8574/A, MCP23017) ──────────────────────────────────────

config BLUSYS_GPIO_EXPANDER_BASIC_I2C_SDA
    int "I2C SDA GPIO"
    depends on !BLUSYS_GPIO_EXPANDER_BASIC_IC_MCP23S17
    range 0 48
    default 21 if IDF_TARGET_ESP32
    default 8  if IDF_TARGET_ESP32C3
    default 8  if IDF_TARGET_ESP32S3
    help
        GPIO connected to the I2C SDA line.

config BLUSYS_GPIO_EXPANDER_BASIC_I2C_SCL
    int "I2C SCL GPIO"
    depends on !BLUSYS_GPIO_EXPANDER_BASIC_IC_MCP23S17
    range 0 48
    default 22 if IDF_TARGET_ESP32
    default 9  if IDF_TARGET_ESP32C3
    default 9  if IDF_TARGET_ESP32S3
    help
        GPIO connected to the I2C SCL line.

config BLUSYS_GPIO_EXPANDER_BASIC_I2C_ADDR
    hex "I2C device address (7-bit)"
    depends on !BLUSYS_GPIO_EXPANDER_BASIC_IC_MCP23S17
    default 0x20
    help
        7-bit I2C address of the expander. PCF8574: 0x20–0x27 (A2:A0 pins).
        PCF8574A: 0x38–0x3F. MCP23017: 0x20–0x27.

# ── SPI settings (MCP23S17) ──────────────────────────────────────────────────

config BLUSYS_GPIO_EXPANDER_BASIC_SPI_SCLK
    int "SPI SCLK GPIO"
    depends on BLUSYS_GPIO_EXPANDER_BASIC_IC_MCP23S17
    range 0 48
    default 18 if IDF_TARGET_ESP32
    default 6  if IDF_TARGET_ESP32C3
    default 12 if IDF_TARGET_ESP32S3

config BLUSYS_GPIO_EXPANDER_BASIC_SPI_MOSI
    int "SPI MOSI GPIO"
    depends on BLUSYS_GPIO_EXPANDER_BASIC_IC_MCP23S17
    range 0 48
    default 23 if IDF_TARGET_ESP32
    default 7  if IDF_TARGET_ESP32C3
    default 11 if IDF_TARGET_ESP32S3

config BLUSYS_GPIO_EXPANDER_BASIC_SPI_MISO
    int "SPI MISO GPIO"
    depends on BLUSYS_GPIO_EXPANDER_BASIC_IC_MCP23S17
    range 0 48
    default 19 if IDF_TARGET_ESP32
    default 2  if IDF_TARGET_ESP32C3
    default 13 if IDF_TARGET_ESP32S3

config BLUSYS_GPIO_EXPANDER_BASIC_SPI_CS
    int "SPI CS GPIO"
    depends on BLUSYS_GPIO_EXPANDER_BASIC_IC_MCP23S17
    range 0 48
    default 5  if IDF_TARGET_ESP32
    default 10 if IDF_TARGET_ESP32C3
    default 10 if IDF_TARGET_ESP32S3

config BLUSYS_GPIO_EXPANDER_BASIC_SPI_HW_ADDR
    int "MCP23S17 hardware address (A2:A0 pins, 0–7)"
    depends on BLUSYS_GPIO_EXPANDER_BASIC_IC_MCP23S17
    range 0 7
    default 0
    help
        Hardware address set by the A0/A1/A2 pins on the MCP23S17.
        Ties to GND = 0, ties to VCC = 1. Default (all GND) = 0.

endmenu
```

## examples/gpio_interrupt/main/Kconfig.projbuild
```kconfig
menu "Blusys GPIO Interrupt Example"

config BLUSYS_GPIO_INTERRUPT_INPUT_PIN
    int "Interrupt input GPIO pin"
    range 0 48
    default 16 if IDF_TARGET_ESP32
    default 2 if IDF_TARGET_ESP32C3
    default 5 if IDF_TARGET_ESP32S3
    help
        Select a board-safe input-capable GPIO for this example.

config BLUSYS_GPIO_INTERRUPT_PULL_UP
    bool "Enable pull-up on the interrupt pin"
    default y
    help
        Enable the internal pull-up for simple button or jumper tests.

endmenu
```

## examples/http_client_basic/main/Kconfig.projbuild
```kconfig
menu "HTTP Client Basic Example"

    config WIFI_SSID
        string "WiFi SSID"
        default "myssid"
        help
            SSID (network name) of the access point to connect to.

    config WIFI_PASSWORD
        string "WiFi Password"
        default "mypassword"
        help
            WiFi password. Leave empty for open networks.

    config WIFI_CONNECT_TIMEOUT_MS
        int "WiFi connect timeout (ms)"
        default 10000
        range 1000 60000
        help
            Maximum time in milliseconds to wait for an IP address.

    config HTTP_CLIENT_URL
        string "HTTP request URL"
        default "http://httpbin.org/get"
        help
            Full URL to fetch with an HTTP GET request.
            Use http:// for plain HTTP or https:// for TLS (no cert verification by default).

    config HTTP_CLIENT_TIMEOUT_MS
        int "HTTP request timeout (ms)"
        default 10000
        range 1000 60000
        help
            Maximum time in milliseconds to wait for the HTTP response.

endmenu
```

## examples/i2c_scan/main/Kconfig.projbuild
```kconfig
menu "Blusys I2C Scan Example"

config BLUSYS_I2C_SCAN_PORT
    int "I2C port"
    range 0 1
    default 0
    help
        Select the I2C controller used by this scan example.

config BLUSYS_I2C_SCAN_SDA_PIN
    int "SDA GPIO pin"
    range 0 48
    default 21 if IDF_TARGET_ESP32
    default 8 if IDF_TARGET_ESP32C3
    default 8 if IDF_TARGET_ESP32S3
    help
        Select a board-safe SDA GPIO for this example.

config BLUSYS_I2C_SCAN_SCL_PIN
    int "SCL GPIO pin"
    range 0 48
    default 22 if IDF_TARGET_ESP32
    default 9 if IDF_TARGET_ESP32C3
    default 9 if IDF_TARGET_ESP32S3
    help
        Select a board-safe SCL GPIO for this example.

endmenu
```

## examples/i2s_basic/main/Kconfig.projbuild
```kconfig
menu "Blusys I2S Basic Example"

config BLUSYS_I2S_BASIC_PORT
    int "I2S port"
    range 0 1
    default 0
    help
        Select the I2S controller port to use.

config BLUSYS_I2S_BASIC_BCLK_PIN
    int "I2S BCLK GPIO pin"
    range 0 48
    default 26 if IDF_TARGET_ESP32
    default 4 if IDF_TARGET_ESP32C3
    default 4 if IDF_TARGET_ESP32S3
    help
        Select the GPIO connected to the external I2S codec or DAC bit clock input.

config BLUSYS_I2S_BASIC_WS_PIN
    int "I2S WS GPIO pin"
    range 0 48
    default 25 if IDF_TARGET_ESP32
    default 5 if IDF_TARGET_ESP32C3
    default 5 if IDF_TARGET_ESP32S3
    help
        Select the GPIO connected to the external I2S codec or DAC word select input.

config BLUSYS_I2S_BASIC_DOUT_PIN
    int "I2S data output GPIO pin"
    range 0 48
    default 22 if IDF_TARGET_ESP32
    default 6 if IDF_TARGET_ESP32C3
    default 6 if IDF_TARGET_ESP32S3
    help
        Select the GPIO connected to the external I2S codec or DAC data input.

config BLUSYS_I2S_BASIC_MCLK_PIN
    int "I2S MCLK GPIO pin (-1 to disable)"
    range -1 48
    default -1
    help
        Set to -1 when the external device does not require MCLK.

config BLUSYS_I2S_BASIC_SAMPLE_RATE_HZ
    int "I2S sample rate"
    range 8000 96000
    default 16000
    help
        Select the sample rate used for the generated stereo square wave.

endmenu
```

## examples/i2s_rx_basic/main/Kconfig.projbuild
```kconfig
menu "Blusys I2S RX Basic Example"

config BLUSYS_I2S_RX_BASIC_BCLK_PIN
    int "I2S bit clock pin (BCLK)"
    range 0 48
    default 4
    help
        GPIO pin for the I2S bit clock output (master drives this).

config BLUSYS_I2S_RX_BASIC_WS_PIN
    int "I2S word select pin (WS / LRCLK)"
    range 0 48
    default 5
    help
        GPIO pin for the I2S word select output (master drives this).

config BLUSYS_I2S_RX_BASIC_DIN_PIN
    int "I2S data input pin (DIN)"
    range 0 48
    default 6
    help
        GPIO pin for the I2S serial data input (microphone or ADC drives this).

config BLUSYS_I2S_RX_BASIC_SAMPLE_RATE_HZ
    int "Sample rate (Hz)"
    default 16000
    help
        Audio sample rate in Hz. Common values: 8000, 16000, 44100, 48000.

endmenu
```

## examples/lcd_ssd1306_basic/main/Kconfig.projbuild
```kconfig
menu "Blusys LCD SSD1306 Basic Example"

config BLUSYS_LCD_SSD1306_I2C_PORT
    int "I2C port"
    range 0 1
    default 0

config BLUSYS_LCD_SSD1306_SDA_PIN
    int "SDA GPIO pin"
    default 21 if IDF_TARGET_ESP32
    default 5 if IDF_TARGET_ESP32C3
    default 1 if IDF_TARGET_ESP32S3

config BLUSYS_LCD_SSD1306_SCL_PIN
    int "SCL GPIO pin"
    default 22 if IDF_TARGET_ESP32
    default 6 if IDF_TARGET_ESP32C3
    default 2 if IDF_TARGET_ESP32S3

config BLUSYS_LCD_SSD1306_DEV_ADDR
    hex "I2C device address"
    default 0x3C

config BLUSYS_LCD_SSD1306_RST_PIN
    int "RST GPIO pin (-1 if not used)"
    default -1

config BLUSYS_LCD_SSD1306_I2C_FREQ_HZ
    int "I2C frequency Hz"
    default 400000

endmenu
```
