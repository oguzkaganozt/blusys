## examples/validation/hal_io_lab/main/Kconfig.projbuild
```kconfig
choice HAL_IO_LAB_SCENARIO
    prompt "HAL I/O lab scenario"
    default HAL_IO_LAB_SCENARIO_SYSTEM_INFO
    help
        Pick one embedded HAL smoke demo (same as former standalone validation apps).

config HAL_IO_LAB_SCENARIO_GPIO_INTERRUPT
    bool "gpio_interrupt"
config HAL_IO_LAB_SCENARIO_PCNT_BASIC
    bool "pcnt_basic"
config HAL_IO_LAB_SCENARIO_MCPWM_BASIC
    bool "mcpwm_basic"
config HAL_IO_LAB_SCENARIO_SDM_BASIC
    bool "sdm_basic"
config HAL_IO_LAB_SCENARIO_DAC_BASIC
    bool "dac_basic"
config HAL_IO_LAB_SCENARIO_LED_STRIP_BASIC
    bool "led_strip_basic"
config HAL_IO_LAB_SCENARIO_SEVEN_SEG_BASIC
    bool "seven_seg_basic"
config HAL_IO_LAB_SCENARIO_BUZZER_BASIC
    bool "buzzer_basic"
config HAL_IO_LAB_SCENARIO_DHT_BASIC
    bool "dht_basic"
config HAL_IO_LAB_SCENARIO_TEMP_SENSOR_BASIC
    bool "temp_sensor_basic"
config HAL_IO_LAB_SCENARIO_ONE_WIRE_BASIC
    bool "one_wire_basic"
config HAL_IO_LAB_SCENARIO_TOUCH_BASIC
    bool "touch_basic"
config HAL_IO_LAB_SCENARIO_ULP_GPIO_WATCH
    bool "ulp_gpio_watch"
config HAL_IO_LAB_SCENARIO_EFUSE_INFO
    bool "efuse_info"
config HAL_IO_LAB_SCENARIO_WDT_BASIC
    bool "wdt_basic"
config HAL_IO_LAB_SCENARIO_SLEEP_BASIC
    bool "sleep_basic"
config HAL_IO_LAB_SCENARIO_SYSTEM_INFO
    bool "system_info"
endchoice

# --- from gpio_interrupt ---
menu "gpio_interrupt pins/options"
    depends on CONFIG_HAL_IO_LAB_SCENARIO_GPIO_INTERRUPT
    menu "Blusys GPIO Interrupt Example"

    config BLUSYS_GPIO_INTERRUPT_INPUT_PIN
        int "Interrupt input GPIO pin"
        range 0 48
        default 16 if IDF_TARGET_ESP32
        default 2 if IDF_TARGET_ESP32C3
        default 5 if IDF_TARGET_ESP32S3
        help
            Select a board-safe input-capable GPIO for this example.

    config BLUSYS_GPIO_INTERRUPT_PULL_UP
        bool "Enable pull-up on the interrupt pin"
        default y
        help
            Enable the internal pull-up for simple button or jumper tests.

    endmenu
endmenu

# --- from pcnt_basic ---
menu "pcnt_basic pins/options"
    depends on CONFIG_HAL_IO_LAB_SCENARIO_PCNT_BASIC
    menu "Blusys PCNT Basic Example"

    config BLUSYS_PCNT_BASIC_PWM_PIN
        int "PWM output GPIO pin"
        range 0 48
        default 4 if IDF_TARGET_ESP32
        default 3 if IDF_TARGET_ESP32C3
        default 4 if IDF_TARGET_ESP32S3
        help
            Select a board-safe PWM-capable output GPIO for the pulse source.

    config BLUSYS_PCNT_BASIC_INPUT_PIN
        int "PCNT input GPIO pin"
        range 0 48
        default 5 if IDF_TARGET_ESP32
        default 4 if IDF_TARGET_ESP32C3
        default 5 if IDF_TARGET_ESP32S3
        help
            Select a GPIO to receive the looped-back pulse input.

    endmenu
endmenu

# --- from mcpwm_basic ---
menu "mcpwm_basic pins/options"
    depends on CONFIG_HAL_IO_LAB_SCENARIO_MCPWM_BASIC
    menu "Blusys MCPWM Basic Example"

    config BLUSYS_MCPWM_BASIC_PIN_A
        int "MCPWM pin A (high-side output)"
        range 0 48
        default 18
        help
            GPIO pin for the high-side (gen_a) PWM output. On unsupported targets the example
            reports mcpwm as unsupported and exits without driving any GPIO.

    config BLUSYS_MCPWM_BASIC_PIN_B
        int "MCPWM pin B (low-side complementary output)"
        range 0 48
        default 19
        help
            GPIO pin for the low-side (gen_b) complementary PWM output. Must differ from pin A.

    endmenu
endmenu

# --- from sdm_basic ---
menu "sdm_basic pins/options"
    depends on CONFIG_HAL_IO_LAB_SCENARIO_SDM_BASIC
    menu "Blusys SDM Basic Example"

    config BLUSYS_SDM_BASIC_PIN
        int "SDM output pin"
        range 0 48
        default 8
        help
            GPIO pin for the sigma-delta modulated output. Connect an RC low-pass filter
            (e.g. 1 kOhm + 100 nF) to observe the smoothed analog voltage.

    config BLUSYS_SDM_BASIC_SAMPLE_RATE_HZ
        int "SDM sample rate (Hz)"
        default 1000000
        help
            Over-sample rate in Hz. Controls the carrier pulse frequency of the SDM output.
            Higher values move the noise further from baseband. 1 MHz is a good default.

    endmenu
endmenu

# --- from dac_basic ---
menu "dac_basic pins/options"
    depends on CONFIG_HAL_IO_LAB_SCENARIO_DAC_BASIC
    menu "Blusys DAC Basic Example"

    config BLUSYS_DAC_BASIC_PIN
        int "DAC GPIO pin"
        range 0 48
        default 25 if IDF_TARGET_ESP32
        default 25 if IDF_TARGET_ESP32C3
        default 25 if IDF_TARGET_ESP32S3
        help
            Select GPIO25 or GPIO26 on ESP32. On unsupported targets the example reports DAC as unsupported.

    endmenu
endmenu

# --- from led_strip_basic ---
menu "led_strip_basic pins/options"
    depends on CONFIG_HAL_IO_LAB_SCENARIO_LED_STRIP_BASIC
    menu "Blusys LED Strip Basic Example"

    config BLUSYS_LED_STRIP_PIN
        int "LED strip data GPIO pin"
        range 0 48
        default 18 if IDF_TARGET_ESP32
        default 8  if IDF_TARGET_ESP32C3
        default 48 if IDF_TARGET_ESP32S3
        help
            GPIO pin connected to the DIN of the WS2812B LED strip.
            Use a board-safe output GPIO; change via menuconfig if needed.

    config BLUSYS_LED_STRIP_LED_COUNT
        int "Number of LEDs in the strip"
        range 1 300
        default 8
        help
            Total number of WS2812B LEDs on the strip.

    endmenu
endmenu

# --- from seven_seg_basic ---
menu "seven_seg_basic pins/options"
    depends on CONFIG_HAL_IO_LAB_SCENARIO_SEVEN_SEG_BASIC
    menu "7-Segment Display Example"

        choice EXAMPLE_DRIVER
            prompt "Driver type"
            default EXAMPLE_DRIVER_MAX7219
            help
                Select the 7-segment display driver to use.

            config EXAMPLE_DRIVER_GPIO
                bool "Direct GPIO"
            config EXAMPLE_DRIVER_74HC595
                bool "74HC595 shift register"
            config EXAMPLE_DRIVER_MAX7219
                bool "MAX7219 SPI controller"
        endchoice

        if EXAMPLE_DRIVER_GPIO
            config EXAMPLE_GPIO_PIN_A
                int "Segment A pin"
                default 2
            config EXAMPLE_GPIO_PIN_B
                int "Segment B pin"
                default 4
            config EXAMPLE_GPIO_PIN_C
                int "Segment C pin"
                default 5
            config EXAMPLE_GPIO_PIN_D
                int "Segment D pin"
                default 18
            config EXAMPLE_GPIO_PIN_E
                int "Segment E pin"
                default 19
            config EXAMPLE_GPIO_PIN_F
                int "Segment F pin"
                default 21
            config EXAMPLE_GPIO_PIN_G
                int "Segment G pin"
                default 22
            config EXAMPLE_GPIO_PIN_DP
                int "Decimal point pin (-1 to disable)"
                default -1
            config EXAMPLE_GPIO_COMMON0
                int "Common pin digit 0"
                default 23
            config EXAMPLE_GPIO_COMMON1
                int "Common pin digit 1 (-1 to disable)"
                default -1
            config EXAMPLE_GPIO_COMMON2
                int "Common pin digit 2 (-1 to disable)"
                default -1
            config EXAMPLE_GPIO_COMMON3
                int "Common pin digit 3 (-1 to disable)"
                default -1
            config EXAMPLE_GPIO_DIGIT_COUNT
                int "Number of digits (1-8)"
                default 1
                range 1 8
            config EXAMPLE_GPIO_COMMON_ANODE
                bool "Common anode (uncheck for common cathode)"
                default n
        endif

        if EXAMPLE_DRIVER_74HC595
            config EXAMPLE_595_DATA_PIN
                int "74HC595 DATA (SER) pin"
                default 13
            config EXAMPLE_595_CLK_PIN
                int "74HC595 CLK (SRCLK) pin"
                default 14
            config EXAMPLE_595_LATCH_PIN
                int "74HC595 LATCH (RCLK) pin"
                default 15
            config EXAMPLE_595_COMMON0
                int "Common pin digit 0"
                default 16
            config EXAMPLE_595_COMMON1
                int "Common pin digit 1 (-1 to disable)"
                default -1
            config EXAMPLE_595_COMMON2
                int "Common pin digit 2 (-1 to disable)"
                default -1
            config EXAMPLE_595_COMMON3
                int "Common pin digit 3 (-1 to disable)"
                default -1
            config EXAMPLE_595_DIGIT_COUNT
                int "Number of digits (1-8)"
                default 1
                range 1 8
            config EXAMPLE_595_COMMON_ANODE
                bool "Common anode (uncheck for common cathode)"
                default n
        endif

        if EXAMPLE_DRIVER_MAX7219
            config EXAMPLE_MAX_MOSI_PIN
                int "MAX7219 MOSI pin"
                default 23
            config EXAMPLE_MAX_CLK_PIN
                int "MAX7219 CLK pin"
                default 18
            config EXAMPLE_MAX_CS_PIN
                int "MAX7219 CS pin"
                default 5
            config EXAMPLE_MAX_DIGIT_COUNT
                int "Number of digits (1-8)"
                default 4
                range 1 8
        endif

    endmenu
endmenu

# --- from buzzer_basic ---
menu "buzzer_basic pins/options"
    depends on CONFIG_HAL_IO_LAB_SCENARIO_BUZZER_BASIC
    menu "Blusys Buzzer Basic Example"

    config BLUSYS_BUZZER_BASIC_PIN
        int "Buzzer GPIO pin"
        range 0 48
        default 18 if IDF_TARGET_ESP32
        default 3  if IDF_TARGET_ESP32C3
        default 8  if IDF_TARGET_ESP32S3
        help
            GPIO pin connected to the passive piezo buzzer signal pin.
            Connect the other buzzer terminal to GND.

    config BLUSYS_BUZZER_BASIC_DUTY_PERMILLE
        int "PWM duty cycle (permille, 1-1000)"
        range 1 1000
        default 500
        help
            Duty cycle for the PWM signal driving the buzzer.
            500 (50% square wave) gives maximum volume for a passive piezo.
            Lower values reduce volume.

    endmenu
endmenu

# --- from dht_basic ---
menu "dht_basic pins/options"
    depends on CONFIG_HAL_IO_LAB_SCENARIO_DHT_BASIC
    menu "Blusys DHT Basic Example"

    config BLUSYS_DHT_BASIC_PIN
        int "DHT data GPIO pin"
        range 0 48
        default 4  if IDF_TARGET_ESP32
        default 3  if IDF_TARGET_ESP32C3
        default 4  if IDF_TARGET_ESP32S3
        help
            GPIO pin connected to the DHT sensor data line.
            An external 4.7 kOhm pull-up resistor to 3.3 V is required.

    choice BLUSYS_DHT_BASIC_TYPE
        prompt "DHT sensor type"
        default BLUSYS_DHT_BASIC_TYPE_DHT22
        help
            Select the DHT sensor model connected to the board.

    config BLUSYS_DHT_BASIC_TYPE_DHT11
        bool "DHT11"

    config BLUSYS_DHT_BASIC_TYPE_DHT22
        bool "DHT22 / AM2302"

    endchoice

    endmenu
endmenu

# --- from temp_sensor_basic ---
menu "temp_sensor_basic pins/options"
    depends on CONFIG_HAL_IO_LAB_SCENARIO_TEMP_SENSOR_BASIC
    menu "Blusys Temperature Sensor Basic Example"
    endmenu
endmenu

# --- from one_wire_basic ---
menu "one_wire_basic pins/options"
    depends on CONFIG_HAL_IO_LAB_SCENARIO_ONE_WIRE_BASIC
    menu "Blusys 1-Wire Basic Example"

    config BLUSYS_ONE_WIRE_BASIC_PIN
        int "1-Wire bus GPIO pin"
        range 0 48
        default 4 if IDF_TARGET_ESP32
        default 3 if IDF_TARGET_ESP32C3
        default 4 if IDF_TARGET_ESP32S3
        help
            GPIO connected to the 1-Wire bus data line.
            Connect a 4.7 kΩ pull-up resistor from this pin to 3.3 V.
            All standard output-capable GPIOs support the required open-drain mode.

    endmenu
endmenu

# --- from touch_basic ---
menu "touch_basic pins/options"
    depends on CONFIG_HAL_IO_LAB_SCENARIO_TOUCH_BASIC
    menu "Blusys Touch Basic Example"

    config BLUSYS_TOUCH_BASIC_PIN
        int "Touch GPIO pin"
        range 0 48
        default 4 if IDF_TARGET_ESP32
        default 4 if IDF_TARGET_ESP32C3
        default 4 if IDF_TARGET_ESP32S3
        help
            Select a touch-capable GPIO on supported targets. On ESP32-C3 the example reports touch as unsupported.

    endmenu
endmenu

# --- from ulp_gpio_watch ---
# (no Kconfig.projbuild in original)

# --- from efuse_info ---
# (no Kconfig.projbuild in original)

# --- from wdt_basic ---
menu "wdt_basic pins/options"
    depends on CONFIG_HAL_IO_LAB_SCENARIO_WDT_BASIC
    menu "Blusys WDT Basic Example"
    endmenu
endmenu

# --- from sleep_basic ---
menu "sleep_basic pins/options"
    depends on CONFIG_HAL_IO_LAB_SCENARIO_SLEEP_BASIC
    menu "Blusys Sleep Basic Example"
    endmenu
endmenu

# --- from system_info ---
menu "system_info pins/options"
    depends on CONFIG_HAL_IO_LAB_SCENARIO_SYSTEM_INFO
    menu "Blusys System Info Example"
    endmenu
endmenu
```

## examples/validation/headless_telemetry_low_power/main/Kconfig.projbuild
```kconfig
menu "Headless telemetry + low power validation"

    config WIFI_SSID
        string "WiFi SSID"
        default "myssid"
        help
            SSID of the AP to connect to.

    config WIFI_PASSWORD
        string "WiFi Password"
        default "mypassword"
        help
            Password of the AP. Leave empty for open networks.

endmenu
```

## examples/validation/headless_telemetry_low_power/sdkconfig.defaults
```kconfig
# Policy: low_power — must stay aligned with templates/scaffold/catalog.yml (policies.low_power)
CONFIG_PM_ENABLE=y
CONFIG_BLUSYS_LOG_DEFAULT_LEVEL_INFO=y
```

## examples/validation/i2c_slave_basic/main/Kconfig.projbuild
```kconfig
menu "Blusys I2C Slave Basic Example"

config BLUSYS_I2C_SLAVE_BASIC_SDA_PIN
    int "I2C SDA pin"
    range 0 48
    default 8
    help
        GPIO pin for the I2C data line. Requires an external pull-up resistor (e.g. 4.7 kOhm to 3.3V).

config BLUSYS_I2C_SLAVE_BASIC_SCL_PIN
    int "I2C SCL pin"
    range 0 48
    default 9
    help
        GPIO pin for the I2C clock line. Requires an external pull-up resistor (e.g. 4.7 kOhm to 3.3V).

config BLUSYS_I2C_SLAVE_BASIC_ADDR
    hex "I2C slave address (7-bit)"
    default 0x55
    help
        7-bit I2C address this device will respond to.

endmenu
```

## examples/validation/local_ctrl_basic/main/Kconfig.projbuild
```kconfig
menu "Local Control Basic Example"

    config WIFI_SSID
        string "WiFi SSID"
        default "myssid"
        help
            SSID of the AP to connect to.

    config WIFI_PASSWORD
        string "WiFi Password"
        default "mypassword"
        help
            Password of the AP. Leave empty for open networks.

    config WIFI_CONNECT_TIMEOUT_MS
        int "WiFi connect timeout (ms)"
        default 10000
        range 1000 60000
        help
            Maximum time to wait for WiFi connection and IP assignment.

    config LOCAL_CTRL_DEVICE_NAME
        string "Local control device name"
        default "blusys-demo"
        help
            Display name shown by the built-in local control page.

    config LOCAL_CTRL_HTTP_PORT
        int "Local control HTTP port"
        default 80
        range 1 65535
        help
            TCP port used by the local control HTTP server.

endmenu
```
