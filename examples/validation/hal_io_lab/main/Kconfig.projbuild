## examples/validation/platform_lab/main/Kconfig.projbuild
```kconfig
choice PLATFORM_LAB_SCENARIO
    prompt "Platform validation scenario"
    default PLATFORM_LAB_SCENARIO_SMOKE
config PLATFORM_LAB_SCENARIO_SMOKE
    bool "smoke"
config PLATFORM_LAB_SCENARIO_STORAGE
    bool "storage_basic"
config PLATFORM_LAB_SCENARIO_POWER_MGMT
    bool "power_mgmt_basic"
config PLATFORM_LAB_SCENARIO_CONSOLE
    bool "console_basic"
config PLATFORM_LAB_SCENARIO_FRAMEWORK_CORE
    bool "framework_core_basic"
config PLATFORM_LAB_SCENARIO_CONCURRENCY
    bool "concurrency_suite"
endchoice

menu "smoke options"
    depends on CONFIG_PLATFORM_LAB_SCENARIO_SMOKE
    menu "Blusys Smoke Test Example"
    endmenu
endmenu

menu "storage_basic options"
    depends on CONFIG_PLATFORM_LAB_SCENARIO_STORAGE
    choice BLUSYS_STORAGE_BASIC_BACKEND
        prompt "Storage backend to exercise"
        default BLUSYS_STORAGE_BASIC_BACKEND_SPIFFS
        help
            SPIFFS uses the "storage" partition; FAT uses the "ffat" partition (both are present in partitions.csv).
    
    config BLUSYS_STORAGE_BASIC_BACKEND_SPIFFS
        bool "SPIFFS (blusys_fs)"
    
    config BLUSYS_STORAGE_BASIC_BACKEND_FATFS
        bool "FAT (blusys_fatfs)"
    
    endchoice
endmenu

menu "power_mgmt_basic options"
    depends on CONFIG_PLATFORM_LAB_SCENARIO_POWER_MGMT
    menu "Blusys Power Management Basic Example"
    endmenu
endmenu

menu "console_basic options"
    depends on CONFIG_PLATFORM_LAB_SCENARIO_CONSOLE
    menu "Blusys Console Basic Example"
    
    config BLUSYS_CONSOLE_UART_NUM
        int "UART port number for console"
        range 0 2
        default 0
        help
            UART peripheral used for the interactive console.
            UART0 is the default debug/flash port on most devkits.
    
    endmenu
endmenu

menu "concurrency_suite options"
    depends on CONFIG_PLATFORM_LAB_SCENARIO_CONCURRENCY
    choice BLUSYS_CONCURRENCY_SUITE_SCENARIO
        prompt "Concurrency test scenario"
        default BLUSYS_CONCURRENCY_SUITE_TIMER
        help
            Select which HAL concurrency stress test to run (timer needs no wiring;
            SPI/UART need loopback; I2C probes an address with or without a device).
    
    config BLUSYS_CONCURRENCY_SUITE_TIMER
        bool "Timer (start/stop vs ISR)"
    
    config BLUSYS_CONCURRENCY_SUITE_I2C
        bool "I2C master probe"
    
    config BLUSYS_CONCURRENCY_SUITE_SPI
        bool "SPI loopback transfer"
    
    config BLUSYS_CONCURRENCY_SUITE_UART
        bool "UART TX/RX loopback"
    
    endchoice
    
    menu "Concurrency I2C pins"
        depends on BLUSYS_CONCURRENCY_SUITE_I2C
    
    config BLUSYS_CONCURRENCY_I2C_PORT
        int "I2C port"
        range 0 1
        default 0
    
    config BLUSYS_CONCURRENCY_I2C_SDA_PIN
        int "SDA GPIO pin"
        range 0 48
        default 21 if IDF_TARGET_ESP32
        default 8 if IDF_TARGET_ESP32C3
        default 8 if IDF_TARGET_ESP32S3
    
    config BLUSYS_CONCURRENCY_I2C_SCL_PIN
        int "SCL GPIO pin"
        range 0 48
        default 22 if IDF_TARGET_ESP32
        default 9 if IDF_TARGET_ESP32C3
        default 9 if IDF_TARGET_ESP32S3
    
    endmenu
    
    menu "Concurrency SPI pins"
        depends on BLUSYS_CONCURRENCY_SUITE_SPI
    
    config BLUSYS_CONCURRENCY_SPI_BUS
        int "SPI bus"
        range 0 1
        default 0
    
    config BLUSYS_CONCURRENCY_SPI_SCLK_PIN
        int "SCLK GPIO pin"
        range 0 48
        default 18 if IDF_TARGET_ESP32
        default 4 if IDF_TARGET_ESP32C3
        default 12 if IDF_TARGET_ESP32S3
    
    config BLUSYS_CONCURRENCY_SPI_MOSI_PIN
        int "MOSI GPIO pin"
        range 0 48
        default 23 if IDF_TARGET_ESP32
        default 6 if IDF_TARGET_ESP32C3
        default 1 if IDF_TARGET_ESP32S3
    
    config BLUSYS_CONCURRENCY_SPI_MISO_PIN
        int "MISO GPIO pin"
        range 0 48
        default 19 if IDF_TARGET_ESP32
        default 5 if IDF_TARGET_ESP32C3
        default 2 if IDF_TARGET_ESP32S3
    
    config BLUSYS_CONCURRENCY_SPI_CS_PIN
        int "CS GPIO pin"
        range 0 48
        default 25 if IDF_TARGET_ESP32
        default 7 if IDF_TARGET_ESP32C3
        default 10 if IDF_TARGET_ESP32S3
    
    endmenu
    
    menu "Concurrency UART pins"
        depends on BLUSYS_CONCURRENCY_SUITE_UART
    
    config BLUSYS_CONCURRENCY_UART_PORT
        int "UART port"
        range 0 2
        default 1
    
    config BLUSYS_CONCURRENCY_UART_TX_PIN
        int "TX GPIO pin"
        range 0 48
        default 17 if IDF_TARGET_ESP32
        default 21 if IDF_TARGET_ESP32C3
        default 1 if IDF_TARGET_ESP32S3
    
    config BLUSYS_CONCURRENCY_UART_RX_PIN
        int "RX GPIO pin"
        range 0 48
        default 16 if IDF_TARGET_ESP32
        default 20 if IDF_TARGET_ESP32C3
        default 2 if IDF_TARGET_ESP32S3
    
    endmenu
endmenu
```

## examples/validation/platform_lab/sdkconfig.defaults.esp32
```kconfig
CONFIG_PLATFORM_LAB_SCENARIO_SMOKE=y
CONFIG_ESPTOOLPY_FLASHSIZE="4MB"
CONFIG_ESPTOOLPY_FLASHSIZE_4MB=y
```

## examples/validation/rmt_rx_basic/main/Kconfig.projbuild
```kconfig
menu "Blusys RMT RX Basic Example"

config BLUSYS_RMT_RX_BASIC_PIN
    int "RMT RX input pin"
    range 0 48
    default 4
    help
        GPIO pin for the RMT receiver input. Connect an IR receiver module
        (e.g. VS1838B) or any pulse-coded signal source to this pin.

endmenu
```

## examples/validation/sdm_basic/main/Kconfig.projbuild
```kconfig
menu "Blusys SDM Basic Example"

config BLUSYS_SDM_BASIC_PIN
    int "SDM output pin"
    range 0 48
    default 8
    help
        GPIO pin for the sigma-delta modulated output. Connect an RC low-pass filter
        (e.g. 1 kOhm + 100 nF) to observe the smoothed analog voltage.

config BLUSYS_SDM_BASIC_SAMPLE_RATE_HZ
    int "SDM sample rate (Hz)"
    default 1000000
    help
        Over-sample rate in Hz. Controls the carrier pulse frequency of the SDM output.
        Higher values move the noise further from baseband. 1 MHz is a good default.

endmenu
```

## examples/validation/seven_seg_basic/main/Kconfig.projbuild
```kconfig
menu "7-Segment Display Example"

    choice EXAMPLE_DRIVER
        prompt "Driver type"
        default EXAMPLE_DRIVER_MAX7219
        help
            Select the 7-segment display driver to use.

        config EXAMPLE_DRIVER_GPIO
            bool "Direct GPIO"
        config EXAMPLE_DRIVER_74HC595
            bool "74HC595 shift register"
        config EXAMPLE_DRIVER_MAX7219
            bool "MAX7219 SPI controller"
    endchoice

    if EXAMPLE_DRIVER_GPIO
        config EXAMPLE_GPIO_PIN_A
            int "Segment A pin"
            default 2
        config EXAMPLE_GPIO_PIN_B
            int "Segment B pin"
            default 4
        config EXAMPLE_GPIO_PIN_C
            int "Segment C pin"
            default 5
        config EXAMPLE_GPIO_PIN_D
            int "Segment D pin"
            default 18
        config EXAMPLE_GPIO_PIN_E
            int "Segment E pin"
            default 19
        config EXAMPLE_GPIO_PIN_F
            int "Segment F pin"
            default 21
        config EXAMPLE_GPIO_PIN_G
            int "Segment G pin"
            default 22
        config EXAMPLE_GPIO_PIN_DP
            int "Decimal point pin (-1 to disable)"
            default -1
        config EXAMPLE_GPIO_COMMON0
            int "Common pin digit 0"
            default 23
        config EXAMPLE_GPIO_COMMON1
            int "Common pin digit 1 (-1 to disable)"
            default -1
        config EXAMPLE_GPIO_COMMON2
            int "Common pin digit 2 (-1 to disable)"
            default -1
        config EXAMPLE_GPIO_COMMON3
            int "Common pin digit 3 (-1 to disable)"
            default -1
        config EXAMPLE_GPIO_DIGIT_COUNT
            int "Number of digits (1-8)"
            default 1
            range 1 8
        config EXAMPLE_GPIO_COMMON_ANODE
            bool "Common anode (uncheck for common cathode)"
            default n
    endif

    if EXAMPLE_DRIVER_74HC595
        config EXAMPLE_595_DATA_PIN
            int "74HC595 DATA (SER) pin"
            default 13
        config EXAMPLE_595_CLK_PIN
            int "74HC595 CLK (SRCLK) pin"
            default 14
        config EXAMPLE_595_LATCH_PIN
            int "74HC595 LATCH (RCLK) pin"
            default 15
        config EXAMPLE_595_COMMON0
            int "Common pin digit 0"
            default 16
        config EXAMPLE_595_COMMON1
            int "Common pin digit 1 (-1 to disable)"
            default -1
        config EXAMPLE_595_COMMON2
            int "Common pin digit 2 (-1 to disable)"
            default -1
        config EXAMPLE_595_COMMON3
            int "Common pin digit 3 (-1 to disable)"
            default -1
        config EXAMPLE_595_DIGIT_COUNT
            int "Number of digits (1-8)"
            default 1
            range 1 8
        config EXAMPLE_595_COMMON_ANODE
            bool "Common anode (uncheck for common cathode)"
            default n
    endif

    if EXAMPLE_DRIVER_MAX7219
        config EXAMPLE_MAX_MOSI_PIN
            int "MAX7219 MOSI pin"
            default 23
        config EXAMPLE_MAX_CLK_PIN
            int "MAX7219 CLK pin"
            default 18
        config EXAMPLE_MAX_CS_PIN
            int "MAX7219 CS pin"
            default 5
        config EXAMPLE_MAX_DIGIT_COUNT
            int "Number of digits (1-8)"
            default 4
            range 1 8
    endif

endmenu
```

## examples/validation/sntp_basic/main/Kconfig.projbuild
```kconfig
menu "SNTP Basic Example"

    config WIFI_SSID
        string "WiFi SSID"
        default "myssid"
        help
            SSID of the access point.

    config WIFI_PASSWORD
        string "WiFi Password"
        default "mypassword"
        help
            WiFi password.

    config SNTP_SERVER
        string "NTP Server"
        default "pool.ntp.org"
        help
            Hostname of the NTP server.

    config SNTP_SYNC_TIMEOUT_MS
        int "Sync timeout (ms)"
        default 15000
        range 1000 60000
        help
            Maximum time to wait for time synchronization.

endmenu
```

## examples/validation/spi_slave_basic/main/Kconfig.projbuild
```kconfig
menu "Blusys SPI Slave Basic Example"

config BLUSYS_SPI_SLAVE_BASIC_MOSI_PIN
    int "SPI MOSI pin (slave input)"
    range 0 48
    default 11
    help
        GPIO pin for MOSI (Master Out Slave In). This is an input on the slave.

config BLUSYS_SPI_SLAVE_BASIC_MISO_PIN
    int "SPI MISO pin (slave output)"
    range 0 48
    default 13
    help
        GPIO pin for MISO (Master In Slave Out). This is an output on the slave.

config BLUSYS_SPI_SLAVE_BASIC_CLK_PIN
    int "SPI clock pin"
    range 0 48
    default 12
    help
        GPIO pin for the SPI clock signal driven by the master.

config BLUSYS_SPI_SLAVE_BASIC_CS_PIN
    int "SPI chip select pin"
    range 0 48
    default 10
    help
        GPIO pin for chip select (active low), driven by the master.

endmenu
```

## examples/validation/touch_basic/main/Kconfig.projbuild
```kconfig
menu "Blusys Touch Basic Example"

config BLUSYS_TOUCH_BASIC_PIN
    int "Touch GPIO pin"
    range 0 48
    default 4 if IDF_TARGET_ESP32
    default 4 if IDF_TARGET_ESP32C3
    default 4 if IDF_TARGET_ESP32S3
    help
        Select a touch-capable GPIO on supported targets. On ESP32-C3 the example reports touch as unsupported.

endmenu
```

## examples/validation/usb_hid_basic/main/Kconfig.projbuild
```kconfig
menu "USB HID Basic Example"

    choice BLUSYS_USB_HID_BASIC_TRANSPORT
        prompt "HID transport"
        default BLUSYS_USB_HID_BASIC_TRANSPORT_USB
        help
            Select how to receive HID input reports.

        config BLUSYS_USB_HID_BASIC_TRANSPORT_USB
            bool "USB OTG (ESP32-S3 only)"
            help
                Uses USB OTG host with the usb_host_hid class driver.
                Requires the espressif/usb_host_hid managed component.

        config BLUSYS_USB_HID_BASIC_TRANSPORT_BLE
            bool "BLE HOGP (all targets)"
            help
                Scans for and connects to a BLE HID peripheral using
                the NimBLE HOGP client. Requires CONFIG_BT_NIMBLE_ENABLED.
    endchoice

    config BLUSYS_USB_HID_BASIC_BLE_DEVICE_NAME
        string "BLE peripheral name filter (empty = any HID device)"
        default ""
        depends on BLUSYS_USB_HID_BASIC_TRANSPORT_BLE
        help
            If non-empty, only connect to a BLE HID peripheral whose
            advertised name exactly matches this string.

endmenu
```

## examples/validation/usb_peripheral_lab/main/Kconfig.projbuild
```kconfig
choice USB_PERIPHERAL_LAB_SCENARIO
    prompt "USB peripheral lab scenario"
    default USB_PERIPHERAL_LAB_SCENARIO_USB_HOST_BASIC

config USB_PERIPHERAL_LAB_SCENARIO_USB_HOST_BASIC
    bool "usb_host_basic"
config USB_PERIPHERAL_LAB_SCENARIO_USB_DEVICE_BASIC
    bool "usb_device_basic"
    select TINYUSB_CDC_ENABLED
config USB_PERIPHERAL_LAB_SCENARIO_USB_HID_BASIC
    bool "usb_hid_basic"
endchoice

menu "usb_host_basic"
    depends on CONFIG_USB_PERIPHERAL_LAB_SCENARIO_USB_HOST_BASIC
endmenu

menu "usb_device_basic"
    depends on CONFIG_USB_PERIPHERAL_LAB_SCENARIO_USB_DEVICE_BASIC
endmenu

menu "usb_hid_basic"
    depends on CONFIG_USB_PERIPHERAL_LAB_SCENARIO_USB_HID_BASIC
    menu "USB HID Basic Example"

        choice BLUSYS_USB_HID_BASIC_TRANSPORT
            prompt "HID transport"
            default BLUSYS_USB_HID_BASIC_TRANSPORT_USB
            help
                Select how to receive HID input reports.

            config BLUSYS_USB_HID_BASIC_TRANSPORT_USB
                bool "USB OTG (ESP32-S3 only)"
                help
                    Uses USB OTG host with the usb_host_hid class driver.
                    Requires the espressif/usb_host_hid managed component.

            config BLUSYS_USB_HID_BASIC_TRANSPORT_BLE
                bool "BLE HOGP (all targets)"
                help
                    Scans for and connects to a BLE HID peripheral using
                    the NimBLE HOGP client. Requires CONFIG_BT_NIMBLE_ENABLED.
        endchoice

        config BLUSYS_USB_HID_BASIC_BLE_DEVICE_NAME
            string "BLE peripheral name filter (empty = any HID device)"
            default ""
            depends on BLUSYS_USB_HID_BASIC_TRANSPORT_BLE
            help
                If non-empty, only connect to a BLE HID peripheral whose
                advertised name exactly matches this string.

    endmenu
endmenu
```
