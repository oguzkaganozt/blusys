## examples/validation/wifi_mesh_basic/main/Kconfig.projbuild
```kconfig
menu "WiFi Mesh Basic Example"

    config MESH_ID
        string "Mesh Network ID (6 hex bytes, e.g. 77:77:77:77:77:77)"
        default "77:77:77:77:77:77"
        help
            6-byte mesh network identifier. All nodes in the same mesh must
            use the same ID. Format: xx:xx:xx:xx:xx:xx

    config MESH_PASSWORD
        string "Mesh AP Password"
        default "MAP_PASSW0RD"
        help
            Password for the mesh soft-AP. Must be 6-64 characters.
            All nodes in the mesh must use the same password.

    config MESH_CHANNEL
        int "WiFi Channel"
        default 6
        range 0 13
        help
            WiFi channel for the mesh network. Use 0 for auto-select.
            All nodes must be on the same channel.

    config MESH_ROUTER_SSID
        string "Router SSID"
        default "myssid"
        help
            SSID of the upstream router. The root node connects here
            to provide internet access to the mesh.

    config MESH_ROUTER_PASSWORD
        string "Router Password"
        default "mypassword"
        help
            Password for the upstream router. Leave empty for open networks.

    config MESH_MAX_LAYER
        int "Maximum tree depth"
        default 6
        range 1 25
        help
            Maximum number of layers (hops) allowed in the mesh tree.

    config MESH_MAX_CONNECTIONS
        int "Maximum children per node"
        default 6
        range 1 10
        help
            Maximum number of child nodes that each node can accept.

endmenu
```

## examples/validation/wireless_bt_lab/main/Kconfig.projbuild
```kconfig
choice WIRELESS_BT_LAB_SCENARIO
    prompt "Bluetooth Nimble lab scenario"
    default WIRELESS_BT_LAB_SCENARIO_BLUETOOTH_BASIC

config WIRELESS_BT_LAB_SCENARIO_BLUETOOTH_BASIC
    bool "bluetooth_basic"
config WIRELESS_BT_LAB_SCENARIO_BLE_GATT_BASIC
    bool "ble_gatt_basic"
endchoice

menu "bluetooth_basic"
    depends on CONFIG_WIRELESS_BT_LAB_SCENARIO_BLUETOOTH_BASIC
    menu "Bluetooth Basic Example"

        config BT_DEVICE_NAME
            string "BLE Device Name"
            default "blusys-device"
            help
                The GAP device name broadcast in BLE advertising data.
                Maximum 29 bytes (advertising payload is 31 bytes; name AD structure
                uses 2 bytes of overhead).

        choice BT_MODE
            prompt "BLE Operating Mode"
            default BT_MODE_ADVERTISE
            help
                Select whether the device should advertise itself (peripheral role)
                or scan for nearby BLE devices (central role).

            config BT_MODE_ADVERTISE
                bool "Advertise (peripheral)"
            config BT_MODE_SCAN
                bool "Scan (central)"
        endchoice

    endmenu
endmenu

menu "ble_gatt_basic"
    depends on CONFIG_WIRELESS_BT_LAB_SCENARIO_BLE_GATT_BASIC
    menu "Blusys BLE GATT Basic Example"
    endmenu
endmenu
```

## examples/validation/ws_client_basic/main/Kconfig.projbuild
```kconfig
menu "WebSocket Client Basic Example"

    config WIFI_SSID
        string "WiFi SSID"
        default "myssid"
        help
            SSID (network name) of the access point to connect to.

    config WIFI_PASSWORD
        string "WiFi Password"
        default "mypassword"
        help
            WiFi password. Leave empty for open networks.

    config WIFI_CONNECT_TIMEOUT_MS
        int "WiFi connect timeout (ms)"
        default 10000
        range 1000 60000
        help
            Maximum time in milliseconds to wait for an IP address.

    config WS_SERVER_URL
        string "WebSocket server URL"
        default "ws://echo.websocket.events"
        help
            Full WebSocket URL including scheme and path.
            Use ws:// for plain WebSocket or wss:// for TLS.

    config WS_CONNECT_TIMEOUT_MS
        int "WebSocket connect timeout (ms)"
        default 10000
        range 1000 60000
        help
            Maximum time in milliseconds to wait for the WebSocket handshake.

    config WS_SEND_INTERVAL_MS
        int "Message send interval (ms)"
        default 5000
        range 500 60000
        help
            How often to send a test message to the server.

endmenu
```
