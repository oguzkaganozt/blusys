// Atlas reference — platform assembly.
//
// Wires blusys connectivity (Wi-Fi + SNTP) + a custom atlas_capability
// (MQTTS, per-device token, atlas/{id}/up,down/* topics) into a
// reducer-driven product running on ESP-IDF.
//
// Credentials come from include/atlas_config.h, which is generated by
// atlas/scripts/provision-blusys-esp32.sh on the Atlas side. Ship that
// script's output alongside this example; do not hand-edit the header.

#include "core/atlas_logic.hpp"
#include "platform/atlas_capability.hpp"

#include "blusys/framework/app/app.hpp"
#include "blusys/framework/capabilities/connectivity.hpp"
#include "blusys/framework/capabilities/list.hpp"
#include "blusys/hal/log.h"
#include "blusys/hal/system.h"

#if defined(__has_include)
#  if __has_include("atlas_config.h")
#    include "atlas_config.h"
#    define ATLAS_EXAMPLE_HAS_CONFIG 1
#  endif
#endif

#ifndef ATLAS_EXAMPLE_HAS_CONFIG
#  warning "include/atlas_config.h not found — run scripts/provision-blusys-esp32.sh"
#  define ATLAS_DEVICE_ID     "unprovisioned"
#  define ATLAS_MQTT_TOKEN    ""
#  define ATLAS_MQTT_BROKER   "mqtts://localhost:8883"
#  define ATLAS_WIFI_SSID     ""
#  define ATLAS_WIFI_PASSWORD ""
static const char ATLAS_CA_CERT_PEM[] = "";
#endif

#include "sdkconfig.h"

#include <cstdio>
#include <cstdint>

namespace atlas_example::system {

namespace {

constexpr const char *kTag = "atlas_app";

// ---- framework primitives (reusable across products) ----
//
// mqtt_capability: generic device MQTT client. Atlas-specific details
// (topics, retain policy, payload shape) live in atlas_capability below.
// ota_capability: device OTA download + flash. Atlas OTA announcements
// feed into it via request_update(url) — no dedicated firmware_url in cfg.

// Last-Will-and-Testament: broker publishes this (retained) if the session
// drops ungracefully, so the dashboard flips to offline within the MQTT
// keepalive window. The matching retained `"online":true` is republished
// from atlas_capability::on_mqtt_connected() on every (re)connect.
constexpr const char kAtlasLwtTopic[]   = "atlas/" ATLAS_DEVICE_ID "/up/state";
constexpr const char kAtlasLwtPayload[] =
    "{\"online\":false,\"firmwareVersion\":\"" CONFIG_ATLAS_FIRMWARE_VERSION "\"}";

blusys::mqtt_config mqtt_cfg{
    .broker_url         = ATLAS_MQTT_BROKER,
    .client_id          = ATLAS_DEVICE_ID,
    .username           = ATLAS_DEVICE_ID,
    .password           = ATLAS_MQTT_TOKEN,
    .server_cert_pem    = ATLAS_CA_CERT_PEM,
    .connect_timeout_ms = 15000,
    .default_qos        = 1,
    .reconnect_min_ms   = 2000,
    .reconnect_max_ms   = 60000,
    .will_topic         = kAtlasLwtTopic,
    .will_payload       = kAtlasLwtPayload,
    .will_payload_len   = sizeof(kAtlasLwtPayload) - 1,
    .will_qos           = 1,
    .will_retain        = true,
};

blusys::mqtt_capability mqtt{mqtt_cfg};

// Atlas pushes firmware URLs at runtime; ota_config.firmware_url stays
// unset, cert_pem is the same broker CA bundle (Atlas serves OTA over
// MinIO/HTTPS signed by the dev CA).
blusys::ota_config ota_cfg{
    .firmware_url    = nullptr,
    .cert_pem        = ATLAS_CA_CERT_PEM,
    .timeout_ms      = 300000,
    .auto_mark_valid = true,
};

blusys::ota_capability ota{ota_cfg};

// ---- connectivity (Wi-Fi + SNTP) ----
//
// Declared before `atlas` so `atlas_config.connectivity` can point at it.
// Construction order matters only for pointer validity, not runtime start
// order — the `capabilities` list below still dictates start/poll sequence.

blusys::connectivity_config conn_cfg{
    .wifi_ssid          = ATLAS_WIFI_SSID,
    .wifi_password      = ATLAS_WIFI_PASSWORD,
    .auto_reconnect     = true,
    .reconnect_delay_ms = 1000,
    .max_retries        = -1,
    .connect_timeout_ms = 15000,
    .sntp_server        = "pool.ntp.org",
    .sntp_server2       = "time.cloudflare.com",
    // Provisioning intentionally disabled — Atlas provisioning ships
    // credentials via atlas_config.h. Set prov_service_name to enable
    // BLE SoftAP onboarding.
    .prov_skip_if_provisioned = true,
};

blusys::connectivity_capability connectivity{conn_cfg};

// ---- Atlas-specific adapter ----

atlas_config atlas_cfg{
    .device_id        = ATLAS_DEVICE_ID,
    .firmware_version = CONFIG_ATLAS_FIRMWARE_VERSION,
    .connectivity     = &connectivity,
};

atlas_capability atlas{atlas_cfg, &mqtt, &ota};

// Order matters: capabilities start/poll in list order. Connectivity must
// come before mqtt (mqtt waits for mark_network_ready) and before atlas
// (atlas waits for mqtt->connected()).
blusys::capability_list_storage capabilities{&connectivity, &mqtt, &ota, &atlas};

// Periodic tick — plumbs connectivity → mqtt and publishes heartbeat /
// state. Reducer owns all persistent flags (wifi_*/time_synced/
// broker_connected); this function treats state as read-mostly.
void on_tick(blusys::app_ctx &ctx, blusys::app_fx & /*fx*/,
              app_state &state, std::uint32_t now_ms)
{
    const auto *conn = ctx.status_of<blusys::connectivity_capability>();

    // Gate mqtt broker dial on Wi-Fi + SNTP readiness. mqtt_capability
    // handles retries; we only pass the network-ready edge in.
    if (conn != nullptr) {
        mqtt.mark_network_ready(conn->has_ip && conn->time_synced);
    }

    // Read live telemetry at publish time — no state caching.
    std::size_t heap = 0;
    (void)blusys_system_free_heap_bytes(&heap);
    const std::int8_t rssi = (conn != nullptr) ? conn->wifi_rssi : 0;

    // Heartbeat — compact JSON, fire-and-forget.
    if (state.broker_connected &&
        now_ms - state.last_heartbeat_ms >= CONFIG_ATLAS_HEARTBEAT_INTERVAL_MS) {
        state.last_heartbeat_ms = now_ms;
        char buf[192];
        const int n = std::snprintf(buf, sizeof(buf),
            "{\"online\":true,\"firmwareVersion\":\"%s\","
            "\"freeHeap\":%lu,\"rssi\":%d,\"uptimeMs\":%lu}",
            CONFIG_ATLAS_FIRMWARE_VERSION,
            static_cast<unsigned long>(heap),
            static_cast<int>(rssi),
            static_cast<unsigned long>(now_ms));
        if (n > 0 &&
            atlas.publish_heartbeat(buf, static_cast<std::size_t>(n)) == BLUSYS_OK) {
            state.heartbeats_sent++;
        }
    }

    // Retained state snapshot — backend reflects latest firmware +
    // diagnostics after reconnects.
    if (state.broker_connected &&
        now_ms - state.last_state_ms >= CONFIG_ATLAS_STATE_REPORT_INTERVAL_MS) {
        state.last_state_ms = now_ms;
        char buf[256];
        const int n = std::snprintf(buf, sizeof(buf),
            "{\"online\":true,\"firmwareVersion\":\"%s\","
            "\"freeHeap\":%lu,\"rssi\":%d,\"phase\":\"%s\","
            "\"commandsHandled\":%lu,\"heartbeatsSent\":%lu}",
            CONFIG_ATLAS_FIRMWARE_VERSION,
            static_cast<unsigned long>(heap),
            static_cast<int>(rssi),
            op_state_name(state.phase),
            static_cast<unsigned long>(state.commands_handled),
            static_cast<unsigned long>(state.heartbeats_sent));
        if (n > 0 &&
            atlas.publish_state(buf, static_cast<std::size_t>(n)) == BLUSYS_OK) {
            state.states_published++;
        }
    }

    // Light status log — every ~5 seconds at 200ms tick.
    static std::uint32_t last_log_ms = 0;
    if (now_ms - last_log_ms >= 5000) {
        last_log_ms = now_ms;
        BLUSYS_LOGI(kTag,
                    "phase=%s wifi=%d ip=%d time=%d broker=%d heap=%lu rssi=%d",
                    op_state_name(state.phase),
                    state.wifi_connected, state.has_ip, state.time_synced,
                    state.broker_connected,
                    static_cast<unsigned long>(heap),
                    static_cast<int>(rssi));
    }
}

const blusys::app_spec<app_state, action> spec{
    .initial_state = {},
    .update        = update,
    .on_tick       = on_tick,
    .on_event      = on_event,
    .tick_period_ms = 200,
    .capabilities  = &capabilities,
};

}  // namespace

}  // namespace atlas_example::system

BLUSYS_APP_HEADLESS(atlas_example::system::spec)
