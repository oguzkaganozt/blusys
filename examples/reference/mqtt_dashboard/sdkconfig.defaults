## examples/reference/mqtt_dashboard/sdkconfig.defaults
```kconfig
# Same tuning as other dashboard-class LVGL examples on device.
CONFIG_ESP_MAIN_TASK_STACK_SIZE=16384
CONFIG_ESP_TASK_WDT_TIMEOUT_S=30
CONFIG_LV_FONT_MONTSERRAT_14=y
CONFIG_LV_FONT_MONTSERRAT_20=y
CONFIG_PARTITION_TABLE_CUSTOM=y
CONFIG_PARTITION_TABLE_CUSTOM_FILENAME="partitions.csv"
CONFIG_ESPTOOLPY_FLASHSIZE_4MB=y
```

## examples/reference/mqtt_dashboard/sdkconfig.defaults.esp32
```kconfig
# Classic ESP32 + I2C SSD1306 128×64 (SDA=21, SCL=22 per profiles/ssd1306.hpp).
CONFIG_BLUSYS_DASHBOARD_DISPLAY_PROFILE_SSD1306=y
# CONFIG_BLUSYS_DASHBOARD_DISPLAY_PROFILE_ILI9341 is not set
# CONFIG_BLUSYS_DASHBOARD_DISPLAY_PROFILE_ILI9488 is not set
# CONFIG_BLUSYS_DASHBOARD_DISPLAY_PROFILE_ST7735 is not set
# CONFIG_BLUSYS_DASHBOARD_LCD_QEMU_RGB is not set
```

## examples/reference/mqtt_dashboard/sdkconfig.defaults.esp32c3
```kconfig
# ESP32-C3 + SSD1306; I2C SDA=8 / SCL=9 applied in integration/app_main.cpp.
CONFIG_BLUSYS_DASHBOARD_DISPLAY_PROFILE_SSD1306=y
# CONFIG_BLUSYS_DASHBOARD_DISPLAY_PROFILE_ILI9341 is not set
# CONFIG_BLUSYS_DASHBOARD_DISPLAY_PROFILE_ILI9488 is not set
# CONFIG_BLUSYS_DASHBOARD_DISPLAY_PROFILE_ST7735 is not set
# CONFIG_BLUSYS_DASHBOARD_LCD_QEMU_RGB is not set
```

## examples/reference/mqtt_dashboard/sdkconfig.defaults.esp32s3
```kconfig
# ESP32-S3 + SSD1306 128×64 I2C — SDA=GPIO1 / SCL=GPIO2 (see profiles/ssd1306.hpp and dashboard_device_profile).
CONFIG_BLUSYS_DASHBOARD_DISPLAY_PROFILE_SSD1306=y
# CONFIG_BLUSYS_DASHBOARD_DISPLAY_PROFILE_ILI9341 is not set
# CONFIG_BLUSYS_DASHBOARD_DISPLAY_PROFILE_ILI9488 is not set
# CONFIG_BLUSYS_DASHBOARD_DISPLAY_PROFILE_ST7735 is not set
# CONFIG_BLUSYS_DASHBOARD_LCD_QEMU_RGB is not set
```

## examples/reference/wifi_connect/main/Kconfig.projbuild
```kconfig
menu "WiFi Connect Example"

    config WIFI_SSID
        string "WiFi SSID"
        default "myssid"
        help
            SSID (network name) of the access point to connect to.

    config WIFI_PASSWORD
        string "WiFi Password"
        default "mypassword"
        help
            WiFi password. Leave empty for open networks.

    config WIFI_CONNECT_TIMEOUT_MS
        int "Connect timeout (ms)"
        default 10000
        range 1000 60000
        help
            Maximum time in milliseconds to wait for IP assignment after calling connect.

endmenu
```

## examples/rmt_basic/main/Kconfig.projbuild
```kconfig
menu "Blusys RMT Basic Example"

config BLUSYS_RMT_BASIC_PIN
    int "RMT output GPIO pin"
    range 0 48
    default 4 if IDF_TARGET_ESP32
    default 3 if IDF_TARGET_ESP32C3
    default 4 if IDF_TARGET_ESP32S3
    help
        Select a board-safe output GPIO for the RMT waveform.

endmenu
```

## examples/sd_spi_basic/main/Kconfig.projbuild
```kconfig
menu "Blusys SD SPI Basic Example"

    config SD_SPI_HOST
        int "SPI host number (1=SPI2, 2=SPI3)"
        range 1 2
        default 1
        help
            SPI peripheral to use. SPI2_HOST=1 is available on all targets.
            SPI3_HOST=2 is only available on ESP32 and ESP32-S3.

    config SD_SPI_MOSI_PIN
        int "MOSI GPIO pin"
        range 0 48
        default 11
        help
            GPIO connected to SD card MOSI (DI) pin.

    config SD_SPI_MISO_PIN
        int "MISO GPIO pin"
        range 0 48
        default 13
        help
            GPIO connected to SD card MISO (DO) pin.

    config SD_SPI_SCLK_PIN
        int "SCLK GPIO pin"
        range 0 48
        default 12
        help
            GPIO connected to SD card CLK pin.

    config SD_SPI_CS_PIN
        int "CS GPIO pin"
        range 0 48
        default 10
        help
            GPIO connected to SD card CS (chip-select) pin.

endmenu
```

## examples/sdmmc_basic/main/Kconfig.projbuild
```kconfig
menu "Blusys SDMMC Basic Example"

config BLUSYS_SDMMC_BASIC_SLOT
    int "SDMMC host slot"
    range 0 1
    default 0
    help
        SDMMC host slot index (0 is the only slot on ESP32-S3).

config BLUSYS_SDMMC_BASIC_CLK_PIN
    int "SDMMC CLK GPIO pin"
    range 0 48
    default 14 if IDF_TARGET_ESP32
    default 36 if IDF_TARGET_ESP32S3
    default 14
    help
        GPIO pin for SDMMC clock signal.

config BLUSYS_SDMMC_BASIC_CMD_PIN
    int "SDMMC CMD GPIO pin"
    range 0 48
    default 15 if IDF_TARGET_ESP32
    default 35 if IDF_TARGET_ESP32S3
    default 15
    help
        GPIO pin for SDMMC command signal.

config BLUSYS_SDMMC_BASIC_D0_PIN
    int "SDMMC D0 GPIO pin"
    range 0 48
    default 2 if IDF_TARGET_ESP32
    default 37 if IDF_TARGET_ESP32S3
    default 2
    help
        GPIO pin for SDMMC data line 0.

config BLUSYS_SDMMC_BASIC_BUS_WIDTH
    int "SDMMC bus width (1 or 4)"
    range 1 4
    default 1
    help
        Set to 1 for 1-bit mode or 4 for 4-bit mode. In 1-bit mode D1, D2, D3 pins are unused.

config BLUSYS_SDMMC_BASIC_D1_PIN
    int "SDMMC D1 GPIO pin (4-bit mode only)"
    range 0 48
    default 4 if IDF_TARGET_ESP32
    default 38 if IDF_TARGET_ESP32S3
    default 4
    help
        GPIO pin for SDMMC data line 1. Only used when bus width is 4.

config BLUSYS_SDMMC_BASIC_D2_PIN
    int "SDMMC D2 GPIO pin (4-bit mode only)"
    range 0 48
    default 12 if IDF_TARGET_ESP32
    default 39 if IDF_TARGET_ESP32S3
    default 12
    help
        GPIO pin for SDMMC data line 2. Only used when bus width is 4.

config BLUSYS_SDMMC_BASIC_D3_PIN
    int "SDMMC D3 GPIO pin (4-bit mode only)"
    range 0 48
    default 13 if IDF_TARGET_ESP32
    default 40 if IDF_TARGET_ESP32S3
    default 13
    help
        GPIO pin for SDMMC data line 3. Only used when bus width is 4.

config BLUSYS_SDMMC_BASIC_FREQ_HZ
    int "SDMMC clock frequency (Hz)"
    range 400000 40000000
    default 20000000
    help
        SDMMC clock frequency in Hz. 400000 for identification, up to 40000000 for data transfer.

endmenu
```

## examples/spi_loopback/main/Kconfig.projbuild
```kconfig
menu "Blusys SPI Loopback Example"

config BLUSYS_SPI_LOOPBACK_BUS
    int "SPI bus"
    range 0 1
    default 0
    help
        Select the SPI bus used by this loopback example.

config BLUSYS_SPI_LOOPBACK_SCLK_PIN
    int "SCLK GPIO pin"
    range 0 48
    default 18 if IDF_TARGET_ESP32
    default 4 if IDF_TARGET_ESP32C3
    default 12 if IDF_TARGET_ESP32S3
    help
        Select a board-safe SPI clock GPIO for this example.

config BLUSYS_SPI_LOOPBACK_MOSI_PIN
    int "MOSI GPIO pin"
    range 0 48
    default 23 if IDF_TARGET_ESP32
    default 6 if IDF_TARGET_ESP32C3
    default 1 if IDF_TARGET_ESP32S3
    help
        Select a board-safe SPI MOSI GPIO for this example.

config BLUSYS_SPI_LOOPBACK_MISO_PIN
    int "MISO GPIO pin"
    range 0 48
    default 19 if IDF_TARGET_ESP32
    default 5 if IDF_TARGET_ESP32C3
    default 2 if IDF_TARGET_ESP32S3
    help
        Select a board-safe SPI MISO GPIO for this example.

config BLUSYS_SPI_LOOPBACK_CS_PIN
    int "CS GPIO pin"
    range 0 48
    default 25 if IDF_TARGET_ESP32
    default 7 if IDF_TARGET_ESP32C3
    default 10 if IDF_TARGET_ESP32S3
    help
        Select a board-safe SPI chip-select GPIO for this example.

endmenu
```

## examples/twai_basic/main/Kconfig.projbuild
```kconfig
menu "Blusys TWAI Basic Example"

config BLUSYS_TWAI_BASIC_TX_PIN
    int "TWAI TX GPIO pin"
    range 0 48
    default 4 if IDF_TARGET_ESP32
    default 4 if IDF_TARGET_ESP32C3
    default 4 if IDF_TARGET_ESP32S3
    help
        Select the GPIO connected to the external TWAI transceiver TX input.

config BLUSYS_TWAI_BASIC_RX_PIN
    int "TWAI RX GPIO pin"
    range 0 48
    default 5 if IDF_TARGET_ESP32
    default 5 if IDF_TARGET_ESP32C3
    default 5 if IDF_TARGET_ESP32S3
    help
        Select the GPIO connected to the external TWAI transceiver RX output.

config BLUSYS_TWAI_BASIC_BITRATE
    int "TWAI bitrate"
    range 10000 1000000
    default 125000
    help
        Classic TWAI/CAN bitrate in bits per second.

endmenu
```

## examples/uart_async/main/Kconfig.projbuild
```kconfig
menu "Blusys UART Async Example"

config BLUSYS_UART_ASYNC_PORT
    int "UART port"
    range 0 1
    default 1
    help
        Select the UART port used for the async loopback example.

config BLUSYS_UART_ASYNC_TX_PIN
    int "UART TX GPIO pin"
    range 0 48
    default 21 if IDF_TARGET_ESP32C3
    default 17 if IDF_TARGET_ESP32S3
    help
        Select a board-safe TX-capable GPIO for this example.

config BLUSYS_UART_ASYNC_RX_PIN
    int "UART RX GPIO pin"
    range 0 48
    default 20 if IDF_TARGET_ESP32C3
    default 18 if IDF_TARGET_ESP32S3
    help
        Select a board-safe RX-capable GPIO for this example.

endmenu
```

## examples/uart_loopback/main/Kconfig.projbuild
```kconfig
menu "Blusys UART Loopback Example"

config BLUSYS_UART_LOOPBACK_PORT
    int "UART port"
    range 0 2
    default 1
    help
        Select the UART port used by this loopback example.

config BLUSYS_UART_LOOPBACK_TX_PIN
    int "TX GPIO pin"
    range 0 48
    default 17 if IDF_TARGET_ESP32
    default 21 if IDF_TARGET_ESP32C3
    default 1 if IDF_TARGET_ESP32S3
    help
        Select a board-safe TX output GPIO for this example.

config BLUSYS_UART_LOOPBACK_RX_PIN
    int "RX GPIO pin"
    range 0 48
    default 16 if IDF_TARGET_ESP32
    default 20 if IDF_TARGET_ESP32C3
    default 2 if IDF_TARGET_ESP32S3
    help
        Select a board-safe RX input GPIO for this example.

endmenu
```

## examples/ui_basic/main/Kconfig.projbuild
```kconfig
menu "Blusys UI Basic Example"

config BLUSYS_UI_SPI_BUS
    int "SPI bus"
    range 0 1
    default 0

config BLUSYS_UI_SCLK_PIN
    int "SCLK GPIO pin"
    default 18 if IDF_TARGET_ESP32
    default 4 if IDF_TARGET_ESP32C3
    default 12 if IDF_TARGET_ESP32S3

config BLUSYS_UI_MOSI_PIN
    int "MOSI GPIO pin"
    default 23 if IDF_TARGET_ESP32
    default 6 if IDF_TARGET_ESP32C3
    default 11 if IDF_TARGET_ESP32S3

config BLUSYS_UI_CS_PIN
    int "CS GPIO pin"
    default 5 if IDF_TARGET_ESP32
    default 7 if IDF_TARGET_ESP32C3
    default 10 if IDF_TARGET_ESP32S3

config BLUSYS_UI_DC_PIN
    int "DC GPIO pin"
    default 2 if IDF_TARGET_ESP32
    default 3 if IDF_TARGET_ESP32C3
    default 13 if IDF_TARGET_ESP32S3

config BLUSYS_UI_RST_PIN
    int "RST GPIO pin (-1 if not used)"
    default -1

config BLUSYS_UI_BL_PIN
    int "Backlight GPIO pin (-1 if not used)"
    default -1

config BLUSYS_UI_PCLK_HZ
    int "SPI pixel clock Hz"
    default 8000000

config BLUSYS_UI_BUF_LINES
    int "LVGL partial buffer lines"
    range 1 128
    default 20

config BLUSYS_UI_FULL_REFRESH
    bool "Use experimental full-screen LVGL render buffer"
    default n

config BLUSYS_UI_X_OFFSET
    int "ST7735 X offset"
    default 0

config BLUSYS_UI_Y_OFFSET
    int "ST7735 Y offset"
    default 0

config BLUSYS_UI_SWAP_XY
    bool "Swap X/Y"
    default y

config BLUSYS_UI_MIRROR_X
    bool "Mirror X"
    default y

config BLUSYS_UI_MIRROR_Y
    bool "Mirror Y"
    default n

config BLUSYS_UI_INVERT_COLOR
    bool "Invert colors"
    default n

choice BLUSYS_UI_DIAG_SCENE
    prompt "UI diagnostic scene"
    default BLUSYS_UI_DIAG_SCENE_FULL

config BLUSYS_UI_DIAG_SCENE_LABEL_ONLY
    bool "Label only"

config BLUSYS_UI_DIAG_SCENE_FRAME_ONLY
    bool "Frame only"

config BLUSYS_UI_DIAG_SCENE_FULL
    bool "Frame + label"

endchoice

choice BLUSYS_UI_DIAG_FLUSH_STRATEGY
    prompt "LVGL flush diagnostic strategy"
    default BLUSYS_UI_DIAG_FLUSH_ROW_STRIDE

config BLUSYS_UI_DIAG_FLUSH_ROW_STRIDE
    bool "Row-by-row using draw buffer stride"

config BLUSYS_UI_DIAG_FLUSH_ROW_PACKED
    bool "Row-by-row assuming packed rows"

config BLUSYS_UI_DIAG_FLUSH_BAND_STRIDE
    bool "Scratch-band flush using draw buffer stride"

config BLUSYS_UI_DIAG_FLUSH_BAND_PACKED
    bool "Scratch-band flush assuming packed rows"

config BLUSYS_UI_DIAG_FLUSH_DIRECT_PACKED
    bool "One direct area flush assuming packed rows"

endchoice

config BLUSYS_UI_DIAG_LOG_FLUSH
    bool "Log LVGL flush diagnostics"
    default y

endmenu
```

## examples/ui_basic/sdkconfig.defaults
```kconfig
CONFIG_LV_OS_FREERTOS=y
CONFIG_LV_COLOR_DEPTH_16=y
CONFIG_BLUSYS_UI_X_OFFSET=0
CONFIG_BLUSYS_UI_Y_OFFSET=0
CONFIG_BLUSYS_UI_BUF_LINES=20
CONFIG_BLUSYS_UI_DIAG_FLUSH_BAND_STRIDE=y
CONFIG_BLUSYS_UI_DIAG_LOG_FLUSH=y
CONFIG_BLUSYS_UI_DIAG_SCENE_FULL=y
```

## examples/validation/concurrency_i2c/main/Kconfig.projbuild
```kconfig
menu "Blusys Concurrency I2C Test"

config BLUSYS_CONCURRENCY_I2C_PORT
    int "I2C port"
    range 0 1
    default 0
    help
        Select the I2C controller used by this concurrency test.

config BLUSYS_CONCURRENCY_I2C_SDA_PIN
    int "SDA GPIO pin"
    range 0 48
    default 21 if IDF_TARGET_ESP32
    default 8 if IDF_TARGET_ESP32C3
    default 8 if IDF_TARGET_ESP32S3
    help
        Select a board-safe SDA GPIO for this test.

config BLUSYS_CONCURRENCY_I2C_SCL_PIN
    int "SCL GPIO pin"
    range 0 48
    default 22 if IDF_TARGET_ESP32
    default 9 if IDF_TARGET_ESP32C3
    default 9 if IDF_TARGET_ESP32S3
    help
        Select a board-safe SCL GPIO for this test.

endmenu
```

## examples/validation/console_basic/main/Kconfig.projbuild
```kconfig
menu "Blusys Console Basic Example"

config BLUSYS_CONSOLE_UART_NUM
    int "UART port number for console"
    range 0 2
    default 0
    help
        UART peripheral used for the interactive console.
        UART0 is the default debug/flash port on most devkits.

endmenu
```

## examples/validation/dac_basic/main/Kconfig.projbuild
```kconfig
menu "Blusys DAC Basic Example"

config BLUSYS_DAC_BASIC_PIN
    int "DAC GPIO pin"
    range 0 48
    default 25 if IDF_TARGET_ESP32
    default 25 if IDF_TARGET_ESP32C3
    default 25 if IDF_TARGET_ESP32S3
    help
        Select GPIO25 or GPIO26 on ESP32. On unsupported targets the example reports DAC as unsupported.

endmenu
```

## examples/validation/dht_basic/main/Kconfig.projbuild
```kconfig
menu "Blusys DHT Basic Example"

config BLUSYS_DHT_BASIC_PIN
    int "DHT data GPIO pin"
    range 0 48
    default 4  if IDF_TARGET_ESP32
    default 3  if IDF_TARGET_ESP32C3
    default 4  if IDF_TARGET_ESP32S3
    help
        GPIO pin connected to the DHT sensor data line.
        An external 4.7 kOhm pull-up resistor to 3.3 V is required.

choice BLUSYS_DHT_BASIC_TYPE
    prompt "DHT sensor type"
    default BLUSYS_DHT_BASIC_TYPE_DHT22
    help
        Select the DHT sensor model connected to the board.

config BLUSYS_DHT_BASIC_TYPE_DHT11
    bool "DHT11"

config BLUSYS_DHT_BASIC_TYPE_DHT22
    bool "DHT22 / AM2302"

endchoice

endmenu
```
