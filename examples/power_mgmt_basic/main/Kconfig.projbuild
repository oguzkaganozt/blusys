## examples/reference/hal/main/Kconfig.projbuild
```kconfig
choice REF_HAL_REFERENCE_SCENARIO
    prompt "Reference HAL scenario"
    default REF_HAL_REFERENCE_SCENARIO_TIMER_BASIC
    help
        Former standalone reference HAL demos in one project.

config REF_HAL_REFERENCE_SCENARIO_GPIO_BASIC
    bool "gpio_basic"
config REF_HAL_REFERENCE_SCENARIO_PWM_BASIC
    bool "pwm_basic"
config REF_HAL_REFERENCE_SCENARIO_BUTTON_BASIC
    bool "button_basic"
config REF_HAL_REFERENCE_SCENARIO_TIMER_BASIC
    bool "timer_basic"
config REF_HAL_REFERENCE_SCENARIO_NVS_BASIC
    bool "nvs_basic"
config REF_HAL_REFERENCE_SCENARIO_ADC_BASIC
    bool "adc_basic"
config REF_HAL_REFERENCE_SCENARIO_SPI_LOOPBACK
    bool "spi_loopback"
config REF_HAL_REFERENCE_SCENARIO_I2C_SCAN
    bool "i2c_scan"
config REF_HAL_REFERENCE_SCENARIO_UART_BASIC
    bool "uart_basic"
endchoice

menu "gpio_basic options"
    depends on CONFIG_REF_HAL_REFERENCE_SCENARIO_GPIO_BASIC
    menu "Blusys GPIO Basic Example"

    config BLUSYS_GPIO_BASIC_OUTPUT_PIN
        int "Output GPIO pin"
        range 0 48
        default 4 if IDF_TARGET_ESP32
        default 3 if IDF_TARGET_ESP32C3
        default 4 if IDF_TARGET_ESP32S3
        help
            Select a board-safe output-capable GPIO for this example.

    config BLUSYS_GPIO_BASIC_INPUT_PIN
        int "Input GPIO pin"
        range 0 48
        default 16 if IDF_TARGET_ESP32
        default 2 if IDF_TARGET_ESP32C3
        default 5 if IDF_TARGET_ESP32S3
        help
            Select a board-safe input-capable GPIO for this example.

    endmenu
endmenu

menu "pwm_basic options"
    depends on CONFIG_REF_HAL_REFERENCE_SCENARIO_PWM_BASIC
    menu "Blusys PWM Basic Example"

    config BLUSYS_PWM_BASIC_PIN
        int "PWM GPIO pin"
        range 0 48
        default 4 if IDF_TARGET_ESP32
        default 3 if IDF_TARGET_ESP32C3
        default 4 if IDF_TARGET_ESP32S3
        help
            Select a board-safe PWM-capable output GPIO for this example.

    endmenu
endmenu

menu "button_basic options"
    depends on CONFIG_REF_HAL_REFERENCE_SCENARIO_BUTTON_BASIC
    menu "Blusys Button Basic Example"

    config BLUSYS_BUTTON_PIN
        int "Button GPIO pin"
        range 0 48
        default 19 if IDF_TARGET_ESP32
        default 2 if IDF_TARGET_ESP32C3
        default 5 if IDF_TARGET_ESP32S3
        help
            GPIO pin connected to the button. Wire the other side to GND and rely
            on the internal pull-up (active_low = true).

    config BLUSYS_BUTTON_LONG_PRESS_MS
        int "Long-press threshold (ms)"
        range 200 5000
        default 1000
        help
            Duration in milliseconds after which a held button fires a LONG_PRESS
            event. Set to 0 in code to disable long-press detection.

    endmenu
endmenu

menu "timer_basic options"
    depends on CONFIG_REF_HAL_REFERENCE_SCENARIO_TIMER_BASIC
    menu "Blusys Timer Basic Example"
    endmenu
endmenu

menu "nvs_basic options"
    depends on CONFIG_REF_HAL_REFERENCE_SCENARIO_NVS_BASIC
    menu "Blusys NVS Basic Example"
    endmenu
endmenu

menu "adc_basic options"
    depends on CONFIG_REF_HAL_REFERENCE_SCENARIO_ADC_BASIC
    menu "Blusys ADC Basic Example"

    config BLUSYS_ADC_BASIC_PIN
        int "ADC GPIO pin"
        range 0 48
        default 34 if IDF_TARGET_ESP32
        default 4 if IDF_TARGET_ESP32C3
        default 1 if IDF_TARGET_ESP32S3
        help
            Select a board-safe ADC1 GPIO for this example.

    config BLUSYS_ADC_BASIC_ATTEN_DB_12
        bool "Use 12 dB attenuation"
        default y
        help
            Disable this only if you specifically want 0 dB mode for lower input voltages.

    endmenu
endmenu

menu "spi_loopback options"
    depends on CONFIG_REF_HAL_REFERENCE_SCENARIO_SPI_LOOPBACK
    menu "Blusys SPI Loopback Example"

    config BLUSYS_SPI_LOOPBACK_BUS
        int "SPI bus"
        range 0 1
        default 0
        help
            Select the SPI bus used by this loopback example.

    config BLUSYS_SPI_LOOPBACK_SCLK_PIN
        int "SCLK GPIO pin"
        range 0 48
        default 18 if IDF_TARGET_ESP32
        default 4 if IDF_TARGET_ESP32C3
        default 12 if IDF_TARGET_ESP32S3
        help
            Select a board-safe SPI clock GPIO for this example.

    config BLUSYS_SPI_LOOPBACK_MOSI_PIN
        int "MOSI GPIO pin"
        range 0 48
        default 23 if IDF_TARGET_ESP32
        default 6 if IDF_TARGET_ESP32C3
        default 1 if IDF_TARGET_ESP32S3
        help
            Select a board-safe SPI MOSI GPIO for this example.

    config BLUSYS_SPI_LOOPBACK_MISO_PIN
        int "MISO GPIO pin"
        range 0 48
        default 19 if IDF_TARGET_ESP32
        default 5 if IDF_TARGET_ESP32C3
        default 2 if IDF_TARGET_ESP32S3
        help
            Select a board-safe SPI MISO GPIO for this example.

    config BLUSYS_SPI_LOOPBACK_CS_PIN
        int "CS GPIO pin"
        range 0 48
        default 5 if IDF_TARGET_ESP32
        default 7 if IDF_TARGET_ESP32C3
        default 10 if IDF_TARGET_ESP32S3
        help
            Select a board-safe SPI chip-select GPIO for this example.

    endmenu
endmenu

menu "i2c_scan options"
    depends on CONFIG_REF_HAL_REFERENCE_SCENARIO_I2C_SCAN
    menu "Blusys I2C Scan Example"

    config BLUSYS_I2C_SCAN_PORT
        int "I2C port"
        range 0 1
        default 0
        help
            Select the I2C controller used by this scan example.

    config BLUSYS_I2C_SCAN_SDA_PIN
        int "SDA GPIO pin"
        range 0 48
        default 21 if IDF_TARGET_ESP32
        default 8 if IDF_TARGET_ESP32C3
        default 8 if IDF_TARGET_ESP32S3
        help
            Select a board-safe SDA GPIO for this example.

    config BLUSYS_I2C_SCAN_SCL_PIN
        int "SCL GPIO pin"
        range 0 48
        default 22 if IDF_TARGET_ESP32
        default 9 if IDF_TARGET_ESP32C3
        default 9 if IDF_TARGET_ESP32S3
        help
            Select a board-safe SCL GPIO for this example.

    endmenu
endmenu

menu "uart_basic options"
    depends on CONFIG_REF_HAL_REFERENCE_SCENARIO_UART_BASIC
    choice BLUSYS_UART_BASIC_MODE
        prompt "UART example mode"
        default BLUSYS_UART_BASIC_MODE_LOOPBACK
        help
            Loopback: blocking write then read. Async: callback-driven TX/RX with two phases.

        config BLUSYS_UART_BASIC_MODE_LOOPBACK
            bool "Blocking loopback"

        config BLUSYS_UART_BASIC_MODE_ASYNC
            bool "Async callbacks (callback_swap_result)"

    endchoice

    menu "UART pins"

        config BLUSYS_UART_BASIC_PORT
            int "UART port"
            range 0 2
            default 1
            help
                UART controller index for this example.

        config BLUSYS_UART_BASIC_TX_PIN
            int "TX GPIO pin"
            range 0 48
            default 17 if IDF_TARGET_ESP32
            default 21 if IDF_TARGET_ESP32C3
            default 1 if IDF_TARGET_ESP32S3
            help
                Board-safe TX GPIO (wire to RX for loopback).

        config BLUSYS_UART_BASIC_RX_PIN
            int "RX GPIO pin"
            range 0 48
            default 16 if IDF_TARGET_ESP32
            default 20 if IDF_TARGET_ESP32C3
            default 2 if IDF_TARGET_ESP32S3
            help
                Board-safe RX GPIO (wire to TX for loopback).

    endmenu
endmenu
```

## examples/reference/handheld_bluetooth/sdkconfig.defaults
```kconfig
# NimBLE — GAP advertising path used by bluetooth_capability (no GATT services in this example)
CONFIG_BT_ENABLED=y
CONFIG_BT_NIMBLE_ENABLED=y
CONFIG_BT_NIMBLE_ROLE_PERIPHERAL=y
CONFIG_BT_NIMBLE_ROLE_BROADCASTER=y
CONFIG_BT_NIMBLE_ROLE_CENTRAL=n
CONFIG_BT_NIMBLE_ROLE_OBSERVER=n

CONFIG_BLUSYS_LOG_DEFAULT_LEVEL_INFO=y
```

## examples/reference/interactive_dashboard/sdkconfig.defaults
```kconfig
# LVGL + shell + charts init on the main task exceeds the IDF default on esp32c3 (stack canary).
# 16 KiB: 12 KiB was still marginal for some dashboard init + log paths on RISC-V.
CONFIG_ESP_MAIN_TASK_STACK_SIZE=16384
# First-frame LVGL layout can run long without yielding; default 5s idle-task WDT trips on C3.
CONFIG_ESP_TASK_WDT_TIMEOUT_S=30
CONFIG_LV_FONT_MONTSERRAT_14=y
CONFIG_LV_FONT_MONTSERRAT_20=y
# CONFIG_PARTITION_TABLE_SINGLE_APP is not set
CONFIG_PARTITION_TABLE_CUSTOM=y
CONFIG_PARTITION_TABLE_CUSTOM_FILENAME="partitions.csv"
# CONFIG_ESPTOOLPY_FLASHSIZE_2MB is not set
CONFIG_ESPTOOLPY_FLASHSIZE_4MB=y
```

## examples/reference/interactive_dashboard/sdkconfig.defaults.esp32c3
```kconfig
# Default interactive_dashboard for ESP32-C3: I2C SSD1306 128×64.
# I2C pins SDA=8 / SCL=9 are applied in integration/app_main.cpp (dashboard_device_profile).
CONFIG_BLUSYS_DASHBOARD_DISPLAY_PROFILE_SSD1306=y
# CONFIG_BLUSYS_DASHBOARD_DISPLAY_PROFILE_ILI9341 is not set
# CONFIG_BLUSYS_DASHBOARD_DISPLAY_PROFILE_ILI9488 is not set
# CONFIG_BLUSYS_DASHBOARD_DISPLAY_PROFILE_ST7735 is not set
# CONFIG_BLUSYS_DASHBOARD_LCD_QEMU_RGB is not set
```

## examples/reference/interactive_panel/main/Kconfig.projbuild
```kconfig
menu "Interactive Panel Wi-Fi"

    config WIFI_SSID
        string "WiFi SSID"
        default "myssid"
        help
            SSID used by the connectivity capability on device builds.

    config WIFI_PASSWORD
        string "WiFi Password"
        default "mypassword"
        help
            Password for the AP. Leave empty for open networks.

endmenu
```

## examples/reference/interactive_panel/sdkconfig.defaults
```kconfig
# CONFIG_PARTITION_TABLE_SINGLE_APP is not set
CONFIG_PARTITION_TABLE_CUSTOM=y
CONFIG_PARTITION_TABLE_CUSTOM_FILENAME="partitions.csv"
# CONFIG_ESPTOOLPY_FLASHSIZE_2MB is not set
CONFIG_ESPTOOLPY_FLASHSIZE_4MB=y
```

## examples/reference/lcd_basic/main/Kconfig.projbuild
```kconfig
menu "Blusys LCD Basic Example"

config BLUSYS_LCD_BASIC_SPI_BUS
    int "SPI bus"
    range 0 1
    default 0

config BLUSYS_LCD_BASIC_SCLK_PIN
    int "SCLK GPIO pin"
    default 18 if IDF_TARGET_ESP32
    default 4 if IDF_TARGET_ESP32C3
    default 12 if IDF_TARGET_ESP32S3

config BLUSYS_LCD_BASIC_MOSI_PIN
    int "MOSI GPIO pin"
    default 23 if IDF_TARGET_ESP32
    default 6 if IDF_TARGET_ESP32C3
    default 11 if IDF_TARGET_ESP32S3

config BLUSYS_LCD_BASIC_CS_PIN
    int "CS GPIO pin"
    default 5 if IDF_TARGET_ESP32
    default 7 if IDF_TARGET_ESP32C3
    default 10 if IDF_TARGET_ESP32S3

config BLUSYS_LCD_BASIC_DC_PIN
    int "DC GPIO pin"
    default 2 if IDF_TARGET_ESP32
    default 3 if IDF_TARGET_ESP32C3
    default 13 if IDF_TARGET_ESP32S3

config BLUSYS_LCD_BASIC_RST_PIN
    int "RST GPIO pin (-1 if not used)"
    default -1

config BLUSYS_LCD_BASIC_BL_PIN
    int "Backlight GPIO pin (-1 if not used)"
    default -1

config BLUSYS_LCD_BASIC_PCLK_HZ
    int "SPI pixel clock Hz"
    default 20000000

endmenu
```

## examples/reference/mqtt_basic/main/Kconfig.projbuild
```kconfig
menu "MQTT Basic Example"

    config WIFI_SSID
        string "WiFi SSID"
        default "myssid"
        help
            SSID (network name) of the access point to connect to.

    config WIFI_PASSWORD
        string "WiFi Password"
        default "mypassword"
        help
            WiFi password. Leave empty for open networks.

    config WIFI_CONNECT_TIMEOUT_MS
        int "WiFi connect timeout (ms)"
        default 10000
        range 1000 60000
        help
            Maximum time in milliseconds to wait for an IP address.

    config MQTT_BROKER_URL
        string "MQTT broker URL"
        default "mqtt://test.mosquitto.org"
        help
            Full broker URI including scheme and port if non-default.
            Use mqtt:// for plain MQTT (port 1883) or mqtts:// for TLS (port 8883).

    config MQTT_CONNECT_TIMEOUT_MS
        int "MQTT connect timeout (ms)"
        default 10000
        range 1000 60000
        help
            Maximum time in milliseconds to wait for CONNACK from the broker.

endmenu
```

## examples/reference/mqtt_dashboard/main/Kconfig.projbuild
```kconfig
menu "MQTT dashboard (device)"

    config WIFI_SSID
        string "WiFi SSID"
        default "myssid"
        help
            Access point SSID used when building for ESP-IDF.

    config WIFI_PASSWORD
        string "WiFi password"
        default "mypassword"
        help
            WiFi password (empty for open networks).

    config WIFI_CONNECT_TIMEOUT_MS
        int "WiFi connect timeout (ms)"
        default 15000
        range 5000 120000

    config MQTT_BROKER_URL
        string "MQTT broker URL"
        default "mqtt://test.mosquitto.org"
        help
            Plain MQTT URI (port 1883 unless included in URL).

    config MQTT_CONNECT_TIMEOUT_MS
        int "MQTT connect timeout (ms)"
        default 15000
        range 5000 120000

endmenu
```
