## examples/pwm_basic/main/Kconfig.projbuild
```kconfig
menu "Blusys PWM Basic Example"

config BLUSYS_PWM_BASIC_PIN
    int "PWM GPIO pin"
    range 0 48
    default 4 if IDF_TARGET_ESP32
    default 3 if IDF_TARGET_ESP32C3
    default 4 if IDF_TARGET_ESP32S3
    help
        Select a board-safe PWM-capable output GPIO for this example.

endmenu
```

## examples/quickstart/bluetooth_controller/main/Kconfig.projbuild
```kconfig
menu "Bluetooth Controller example"

    config BTCTRL_DEVICE_NAME
        string "BLE advertised name"
        default "Blusys Controller"
        help
            Shown in OS Bluetooth pairing UI. Must be ≤29 characters.

    config BTCTRL_ENCODER_CLK_GPIO
        int "Encoder CLK (A) GPIO"
        default 0
        help
            CLK/A pin of the EC11 rotary encoder. CW rotation emits Volume Up.

    config BTCTRL_ENCODER_DT_GPIO
        int "Encoder DT (B) GPIO"
        default 1
        help
            DT/B pin of the EC11 rotary encoder. CCW rotation emits Volume Down.

    config BTCTRL_ENCODER_SW_GPIO
        int "Encoder switch (button) GPIO"
        default 3
        help
            Push-button pin of the EC11. Press emits Mute/Unmute. -1 to disable.

    config BTCTRL_STATUS_LED_GPIO
        int "Status LED GPIO"
        default -1
        help
            Drives a status LED. Off before advertising, blinks while
            advertising, solid while a client is connected. -1 disables.

    config BTCTRL_STATUS_LED_ACTIVE_LOW
        bool "Status LED is active-low"
        default n

    config BTCTRL_ENCODER_LONG_PRESS_MS
        int "Encoder button long-press threshold (ms)"
        default 600
        help
            Hold time that triggers a long press, which cycles the operating
            mode (volume → media → brightness → volume). Short press still
            performs the context action (mute / play-pause).

    config BTCTRL_BATTERY_ADC_GPIO
        int "Battery voltage ADC GPIO (-1 to disable)"
        default -1
        help
            GPIO connected to a resistor divider across the battery. Sampled
            every 30 s and reported via the BLE Battery Service. -1 disables
            battery reporting (defaults to 100 %).

    config BTCTRL_BATTERY_MV_EMPTY
        int "ADC pin voltage at 0 % battery (mV)"
        default 1500
        help
            Expected ADC pin millivolts when the battery is fully discharged.
            For a LiPo (3.0 V min) through a 1:1 divider this is 1500 mV.

    config BTCTRL_BATTERY_MV_FULL
        int "ADC pin voltage at 100 % battery (mV)"
        default 2100
        help
            Expected ADC pin millivolts when the battery is fully charged.
            For a LiPo (4.2 V max) through a 1:1 divider this is 2100 mV.

    config BTCTRL_SLEEP_TIMEOUT_S
        int "Deep-sleep inactivity timeout in seconds (0 = disabled)"
        default 120
        help
            Seconds of encoder inactivity before the device enters deep sleep.
            Any encoder rotation wakes it (CLK pin low edge). Set 0 to disable.

    config BTCTRL_SIMULATE_ON_CONNECT
        bool "Auto-simulate 3x Vol+ then 3x Vol- once paired"
        default n
        help
            Useful when bringing the firmware up on a dev board without real
            buttons wired. On every client connect, the device emits three
            Volume Increment clicks followed by three Volume Decrement clicks.
            Disable this once real buttons are attached.

    config BTCTRL_DISPLAY_ENABLED
        bool "Enable SSD1306 128x64 OLED display"
        default y
        help
            Show BLE status, active mode, and volume level on a 128x64
            SSD1306 connected via I2C. Requires lvgl/lvgl ~9.2 in
            idf_component.yml.

    config BTCTRL_DISPLAY_I2C_SDA_GPIO
        int "Display I2C SDA GPIO"
        default 8
        depends on BTCTRL_DISPLAY_ENABLED
        help
            SDA pin for the SSD1306 I2C bus.

    config BTCTRL_DISPLAY_I2C_SCL_GPIO
        int "Display I2C SCL GPIO"
        default 9
        depends on BTCTRL_DISPLAY_ENABLED
        help
            SCL pin for the SSD1306 I2C bus.

endmenu
```

## examples/quickstart/bluetooth_controller/sdkconfig.defaults
```kconfig
CONFIG_PARTITION_TABLE_CUSTOM=y
CONFIG_PARTITION_TABLE_CUSTOM_FILENAME="partitions.csv"
# CONFIG_ESPTOOLPY_FLASHSIZE_2MB is not set
CONFIG_ESPTOOLPY_FLASHSIZE_4MB=y

# NimBLE — peripheral role only (HID-over-GATT).
CONFIG_BT_ENABLED=y
CONFIG_BT_NIMBLE_ENABLED=y
CONFIG_BT_NIMBLE_ROLE_PERIPHERAL=y
CONFIG_BT_NIMBLE_ROLE_BROADCASTER=y
# CONFIG_BT_NIMBLE_ROLE_CENTRAL is not set
# CONFIG_BT_NIMBLE_ROLE_OBSERVER is not set
CONFIG_BT_NIMBLE_MAX_CONNECTIONS=1
CONFIG_BT_NIMBLE_SM_SC=y
# Bonds survive reboot. If the HID report map changes, hosts must re-pair
# (forget + re-add the device) or they will reject the new descriptor.
CONFIG_BT_NIMBLE_NVS_PERSIST=y
CONFIG_BT_NIMBLE_MAX_BONDS=3
CONFIG_BT_NIMBLE_MAX_CCCDS=4

# Encoder pins — CLK and DT swapped to correct rotation direction.
CONFIG_BTCTRL_ENCODER_CLK_GPIO=1
CONFIG_BTCTRL_ENCODER_DT_GPIO=0

# Turn on the auto-simulation hook by default so bench-up works without
# buttons. Flip to `# CONFIG_BTCTRL_SIMULATE_ON_CONNECT is not set` once real
# buttons are wired.
# CONFIG_BTCTRL_SIMULATE_ON_CONNECT is not set
CONFIG_BTCTRL_SLEEP_TIMEOUT_S=120

# Status LED disabled — GPIO 8 is used for I2C SDA (SSD1306).
CONFIG_BTCTRL_STATUS_LED_GPIO=-1

# LVGL — required for SSD1306 display
CONFIG_LV_OS_FREERTOS=y
CONFIG_LV_COLOR_DEPTH_16=y
CONFIG_LV_FONT_MONTSERRAT_20=y

# Main task stack: default 3584 is too small once BLE + LVGL widget
# construction run in the same task (run_headless uses app_main directly).
CONFIG_ESP_MAIN_TASK_STACK_SIZE=12288
```

## examples/quickstart/bt_classic_controller/main/Kconfig.projbuild
```kconfig
menu "BT Classic Controller example"

    config BTCC_DEVICE_NAME
        string "Classic BT advertised device name"
        default "Oxa BT Controller"
        help
            Shown in the OS Bluetooth pairing UI.

    config BTCC_ENCODER_CLK_GPIO
        int "Encoder CLK (A) GPIO"
        default 32
        help
            CLK/A pin of the EC11 rotary encoder. CW rotation emits Volume Up.
            Must be an RTC-capable GPIO (0,2,4,12-15,25-27,32-39) to serve as
            an ext1 deep-sleep wakeup source.

    config BTCC_ENCODER_DT_GPIO
        int "Encoder DT (B) GPIO"
        default 33
        help
            DT/B pin of the EC11 rotary encoder. CCW rotation emits Volume Down.

    config BTCC_ENCODER_SW_GPIO
        int "Encoder switch (button) GPIO"
        default 23
        help
            Push-button pin of the EC11. Short press = context action (mute /
            play-pause). -1 to disable.
            NOTE: GPIO23 is NOT an RTC GPIO on the original ESP32; it cannot
            be used as an ext1 deep-sleep wakeup source. Only CLK (GPIO32)
            is used for wakeup.

    config BTCC_ENCODER_LONG_PRESS_MS
        int "Encoder button long-press threshold (ms)"
        default 600
        help
            Hold time that triggers a long press, which cycles the operating
            mode (volume → media → brightness → volume). Short press still
            performs the context action (mute / play-pause).

    config BTCC_STATUS_LED_GPIO
        int "Status LED GPIO (-1 to disable)"
        default -1
        help
            Drives a status LED. Off while idle, blinks while discoverable,
            solid while a client is connected. -1 disables.

    config BTCC_STATUS_LED_ACTIVE_LOW
        bool "Status LED is active-low"
        default n

    config BTCC_BATTERY_ADC_GPIO
        int "Battery voltage ADC GPIO (-1 to disable)"
        default -1
        help
            GPIO connected to a resistor divider across the battery. Sampled
            every 30 s. -1 disables battery reporting.

    config BTCC_BATTERY_MV_EMPTY
        int "ADC pin voltage at 0% battery (mV)"
        default 1500
        help
            Expected ADC pin millivolts when battery is fully discharged.
            For a LiPo (3.0 V min) through a 1:1 divider this is 1500 mV.

    config BTCC_BATTERY_MV_FULL
        int "ADC pin voltage at 100% battery (mV)"
        default 2100
        help
            Expected ADC pin millivolts when battery is fully charged.
            For a LiPo (4.2 V max) through a 1:1 divider this is 2100 mV.

    config BTCC_SLEEP_TIMEOUT_S
        int "Deep-sleep inactivity timeout in seconds (0 = disabled)"
        default 120
        help
            Seconds of encoder inactivity before the device enters deep sleep.
            Wakeup source: ext1 on GPIO32 (CLK) — a low edge on that pin
            (encoder rotation) wakes the device. GPIO23 (SW button) is NOT an
            RTC GPIO on ESP32 and cannot be used for ext1 wakeup. Set 0 to
            disable deep sleep entirely.

    config BTCC_DISPLAY_ENABLED
        bool "Enable SSD1306 128x64 OLED display"
        default y
        help
            Show BLE status, active mode, volume level, and AVRCP track info
            on a 128x64 SSD1306 connected via I2C.

    config BTCC_DISPLAY_I2C_SDA_GPIO
        int "Display I2C SDA GPIO"
        default 21
        depends on BTCC_DISPLAY_ENABLED

    config BTCC_DISPLAY_I2C_SCL_GPIO
        int "Display I2C SCL GPIO"
        default 22
        depends on BTCC_DISPLAY_ENABLED

endmenu
```

## examples/quickstart/bt_classic_controller/sdkconfig.defaults
```kconfig
CONFIG_PARTITION_TABLE_CUSTOM=y
CONFIG_PARTITION_TABLE_CUSTOM_FILENAME="partitions.csv"
# CONFIG_ESPTOOLPY_FLASHSIZE_2MB is not set
CONFIG_ESPTOOLPY_FLASHSIZE_4MB=y

# Bluedroid — Classic BT only.  blusys BLE files compile as empty stubs when
# CONFIG_BT_NIMBLE_ENABLED is not set (they are guarded by #if CONFIG_BT_NIMBLE_ENABLED).
# Disable WiFi entirely — not needed for Classic BT HID/AVRCP controller.
# This frees ~90 KB of BSS, which is critical: Bluedroid + A2DP + AVRCP + HID
# alone consumes most of the ESP32's 320 KB DRAM without WiFi fighting for it.
# CONFIG_ESP_WIFI_ENABLED is not set

CONFIG_BT_ENABLED=y
CONFIG_BT_BLUEDROID_ENABLED=y
CONFIG_BT_CLASSIC_ENABLED=y
# CONFIG_BT_NIMBLE_ENABLED is not set
# CONFIG_BT_BLE_ENABLED is not set
CONFIG_BT_SSP_ENABLED=y

# Set BT controller to BR/EDR-only mode — must match esp_bt_controller_enable(CLASSIC_BT).
# Default sdkconfig has BTDM_CTRL_MODE_BLE_ONLY=y; overriding here to avoid
# ESP_ERR_INVALID_ARG on esp_bt_controller_enable(ESP_BT_MODE_CLASSIC_BT).
CONFIG_BTDM_CTRL_MODE_BR_EDR_ONLY=y

# Classic BT profiles: HID device + A2DP Sink + AVRCP Controller.
# A2DP Sink is a stub (audio discarded) — its sole purpose is to make phones
# automatically connect AVRCP alongside A2DP, enabling track metadata queries.
CONFIG_BT_HID_ENABLED=y
CONFIG_BT_HID_DEVICE_ENABLED=y
CONFIG_BT_A2DP_ENABLE=y
CONFIG_BT_AVRCP_ENABLE=y
CONFIG_BT_AVRCP_CT_ENABLE=y

# Hardware pin defaults (override via sdkconfig or menuconfig).
CONFIG_BTCC_ENCODER_CLK_GPIO=32
CONFIG_BTCC_ENCODER_DT_GPIO=33
CONFIG_BTCC_ENCODER_SW_GPIO=23
CONFIG_BTCC_DISPLAY_I2C_SDA_GPIO=21
CONFIG_BTCC_DISPLAY_I2C_SCL_GPIO=22
CONFIG_BTCC_SLEEP_TIMEOUT_S=120
CONFIG_BTCC_STATUS_LED_GPIO=-1

# LVGL — required for SSD1306 display.
# Reduce heap from 64 KB default to 8 KB: plenty for our 5 simple widgets,
# and frees ~56 KB of BSS that Bluedroid + A2DP + AVRCP badly need.
CONFIG_LV_OS_FREERTOS=y
CONFIG_LV_COLOR_DEPTH_16=y
CONFIG_LV_FONT_MONTSERRAT_14=y
CONFIG_LV_FONT_MONTSERRAT_20=y
# 24 KB: 16 KB for the 128×64 16-bit draw buffer + 8 KB for widget allocations.
# BSS headroom is ~50 KB so this is safe (we freed 56 KB by reducing from 64 KB).
CONFIG_LV_MEM_SIZE_KILOBYTES=24

# Main task stack: BT init (3 profiles) + LVGL widget construction run in app_main.
CONFIG_ESP_MAIN_TASK_STACK_SIZE=16384

# Silence Bluedroid verbose internal logs (default is VERBOSE=5 which floods serial).
CONFIG_BT_LOG_HCI_TRACE_LEVEL=0
CONFIG_BT_LOG_BTM_TRACE_LEVEL=0
CONFIG_BT_LOG_L2CAP_TRACE_LEVEL=0
CONFIG_BT_LOG_RFCOMM_TRACE_LEVEL=0
CONFIG_BT_LOG_SDP_TRACE_LEVEL=0
CONFIG_BT_LOG_GAP_TRACE_LEVEL=0
CONFIG_BT_LOG_BNEP_TRACE_LEVEL=0
CONFIG_BT_LOG_PAN_TRACE_LEVEL=0
CONFIG_BT_LOG_A2D_TRACE_LEVEL=0
CONFIG_BT_LOG_AVDT_TRACE_LEVEL=0
CONFIG_BT_LOG_AVCT_TRACE_LEVEL=0
CONFIG_BT_LOG_AVRC_TRACE_LEVEL=0
CONFIG_BT_LOG_MCA_TRACE_LEVEL=0
CONFIG_BT_LOG_HID_TRACE_LEVEL=0
CONFIG_BT_LOG_APPL_TRACE_LEVEL=0
CONFIG_BT_LOG_GATT_TRACE_LEVEL=0
CONFIG_BT_LOG_SMP_TRACE_LEVEL=0
CONFIG_BT_LOG_BTIF_TRACE_LEVEL=0
CONFIG_BT_LOG_BTC_TRACE_LEVEL=0
CONFIG_BT_LOG_OSI_TRACE_LEVEL=0
CONFIG_BT_LOG_BLUFI_TRACE_LEVEL=0
```

## examples/quickstart/edge_node/main/Kconfig.projbuild
```kconfig
menu "Edge Node Example"

    config WIFI_SSID
        string "WiFi SSID"
        default "myssid"
        help
            SSID of the AP to connect to.

    config WIFI_PASSWORD
        string "WiFi Password"
        default "mypassword"
        help
            Password of the AP. Leave empty for open networks.

endmenu
```

## examples/quickstart/headless/main/Kconfig.projbuild
```kconfig
menu "Headless example"

    config WIFI_SSID
        string "WiFi SSID"
        default "myssid"
        help
            SSID of the AP to connect to.

    config WIFI_PASSWORD
        string "WiFi Password"
        default "mypassword"
        help
            Password of the AP. Leave empty for open networks.

    config BLUSYS_HEADLESS_TELEMETRY_LOCAL_UI
        bool "Local SSD1306 status OLED (128x64 I2C)"
        default n
        help
            When enabled, uses BLUSYS_APP_MAIN_DEVICE with a minimal mono status
            screen (same core/ and capabilities as headless). Host and headless
            simulator builds stay unchanged.

endmenu
```

## examples/quickstart/interactive_controller/main/Kconfig.projbuild
```kconfig
menu "Interactive Controller (Phase 7 display)"

choice BLUSYS_IC_DISPLAY_PROFILE
    prompt "Device display profile"
    default BLUSYS_IC_DISPLAY_PROFILE_ST7735
    help
        SPI TFT used with this quickstart. Host SDL builds use the matching
        window size when BLUSYS_IC_DISPLAY_PROFILE is passed from host CMake.

config BLUSYS_IC_DISPLAY_PROFILE_ST7735
    bool "ST7735 160x128 (canonical)"

config BLUSYS_IC_DISPLAY_PROFILE_ST7789
    bool "ST7789 320x240 landscape"

endchoice

endmenu
```

## examples/reference/atlas/main/Kconfig.projbuild
```kconfig
menu "Atlas example"

    comment "Fallback values used only when include/atlas_config.h is missing."
    comment "Normally produced by scripts/provision-blusys-esp32.sh on the Atlas side."

    config ATLAS_FIRMWARE_VERSION
        string "Firmware version reported in state"
        default "1.0.0-blusys"

    config ATLAS_HEARTBEAT_INTERVAL_MS
        int "Heartbeat publish interval (ms)"
        default 30000
        range 5000 600000

    config ATLAS_STATE_REPORT_INTERVAL_MS
        int "State publish interval (ms)"
        default 300000
        range 30000 3600000

endmenu
```

## examples/reference/atlas/sdkconfig.defaults
```kconfig
# Flash / partitions — dual OTA slots, NVS, SPIFFS
CONFIG_ESPTOOLPY_FLASHSIZE_4MB=y
CONFIG_PARTITION_TABLE_CUSTOM=y
CONFIG_PARTITION_TABLE_CUSTOM_FILENAME="partitions.csv"
# CONFIG_PARTITION_TABLE_SINGLE_APP is not set

# MQTT over TLS — certificate bundle + larger buffers for state payloads.
CONFIG_MQTT_TRANSPORT_SSL=y
CONFIG_MBEDTLS_SSL_IN_CONTENT_LEN=8192
CONFIG_MBEDTLS_SSL_OUT_CONTENT_LEN=4096

# Main task stack — Atlas OTA + mbedTLS pushes beyond the 3.5K default.
CONFIG_ESP_MAIN_TASK_STACK_SIZE=8192

# Enable LWIP SNTP (blusys connectivity capability syncs time from pool.ntp.org).
CONFIG_LWIP_SNTP_MAX_SERVERS=2
```
