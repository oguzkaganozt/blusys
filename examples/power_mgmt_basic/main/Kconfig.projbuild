## examples/reference/button_basic/main/Kconfig.projbuild
```kconfig
menu "Blusys Button Basic Example"

config BLUSYS_BUTTON_PIN
    int "Button GPIO pin"
    range 0 48
    default 19 if IDF_TARGET_ESP32
    default 2 if IDF_TARGET_ESP32C3
    default 5 if IDF_TARGET_ESP32S3
    help
        GPIO pin connected to the button. Wire the other side to GND and rely
        on the internal pull-up (active_low = true).

config BLUSYS_BUTTON_LONG_PRESS_MS
    int "Long-press threshold (ms)"
    range 200 5000
    default 1000
    help
        Duration in milliseconds after which a held button fires a LONG_PRESS
        event. Set to 0 in code to disable long-press detection.

endmenu
```

## examples/reference/connectivity/main/Kconfig.projbuild
```kconfig
choice CONNECTIVITY_SCENARIO
    prompt "Connectivity reference scenario"
    default CONNECTIVITY_SCENARIO_WIFI_CONNECT

config CONNECTIVITY_SCENARIO_WIFI_CONNECT
    bool "wifi_connect"
config CONNECTIVITY_SCENARIO_HTTP_CLIENT
    bool "http_client_basic"
config CONNECTIVITY_SCENARIO_MQTT_BASIC
    bool "mqtt_basic"
endchoice

menu "Shared WiFi credentials"

    config WIFI_SSID
        string "WiFi SSID"
        default "myssid"
        help
            SSID (network name) of the access point to connect to.

    config WIFI_PASSWORD
        string "WiFi Password"
        default "mypassword"
        help
            WiFi password. Leave empty for open networks.

    config WIFI_CONNECT_TIMEOUT_MS
        int "WiFi connect timeout (ms)"
        default 10000
        range 1000 60000
        help
            Maximum time in milliseconds to wait for an IP address.

endmenu

menu "HTTP client"
    depends on CONFIG_CONNECTIVITY_SCENARIO_HTTP_CLIENT

    config HTTP_CLIENT_URL
        string "HTTP request URL"
        default "http://httpbin.org/get"
        help
            Full URL to fetch with an HTTP GET request.

    config HTTP_CLIENT_TIMEOUT_MS
        int "HTTP request timeout (ms)"
        default 10000
        range 1000 60000

endmenu

menu "MQTT"
    depends on CONFIG_CONNECTIVITY_SCENARIO_MQTT_BASIC

    config MQTT_BROKER_URL
        string "MQTT broker URL"
        default "mqtt://test.mosquitto.org"

    config MQTT_CONNECT_TIMEOUT_MS
        int "MQTT connect timeout (ms)"
        default 10000
        range 1000 60000

endmenu
```

## examples/reference/display/main/Kconfig.projbuild
```kconfig
choice DISPLAY_UI_SCENARIO
    prompt "Display reference scenario"
    default DISPLAY_UI_SCENARIO_LCD_BASIC

config DISPLAY_UI_SCENARIO_LCD_BASIC
    bool "lcd_basic"
config DISPLAY_UI_SCENARIO_LCD_ST7735_BASIC
    bool "lcd_st7735_basic"
config DISPLAY_UI_SCENARIO_UI_BASIC
    bool "ui_basic (LVGL)"
config DISPLAY_UI_SCENARIO_ENCODER_BASIC
    bool "encoder_basic"
config DISPLAY_UI_SCENARIO_OLED_ENCODER
    bool "oled_encoder_basic (LVGL + SSD1306)"
endchoice

menu "lcd_basic"
    depends on CONFIG_DISPLAY_UI_SCENARIO_LCD_BASIC
    menu "Blusys LCD Basic Example"

    config BLUSYS_LCD_BASIC_SPI_BUS
        int "SPI bus"
        range 0 1
        default 0

    config BLUSYS_LCD_BASIC_SCLK_PIN
        int "SCLK GPIO pin"
        default 18 if IDF_TARGET_ESP32
        default 4 if IDF_TARGET_ESP32C3
        default 12 if IDF_TARGET_ESP32S3

    config BLUSYS_LCD_BASIC_MOSI_PIN
        int "MOSI GPIO pin"
        default 23 if IDF_TARGET_ESP32
        default 6 if IDF_TARGET_ESP32C3
        default 11 if IDF_TARGET_ESP32S3

    config BLUSYS_LCD_BASIC_CS_PIN
        int "CS GPIO pin"
        default 5 if IDF_TARGET_ESP32
        default 7 if IDF_TARGET_ESP32C3
        default 10 if IDF_TARGET_ESP32S3

    config BLUSYS_LCD_BASIC_DC_PIN
        int "DC GPIO pin"
        default 2 if IDF_TARGET_ESP32
        default 3 if IDF_TARGET_ESP32C3
        default 13 if IDF_TARGET_ESP32S3

    config BLUSYS_LCD_BASIC_RST_PIN
        int "RST GPIO pin (-1 if not used)"
        default -1

    config BLUSYS_LCD_BASIC_BL_PIN
        int "Backlight GPIO pin (-1 if not used)"
        default -1

    config BLUSYS_LCD_BASIC_PCLK_HZ
        int "SPI pixel clock Hz"
        default 20000000

    endmenu
endmenu

menu "lcd_st7735_basic"
    depends on CONFIG_DISPLAY_UI_SCENARIO_LCD_ST7735_BASIC
    menu "Blusys LCD ST7735 Basic Example"

    config BLUSYS_LCD_ST7735_SPI_BUS
        int "SPI bus"
        range 0 1
        default 0

    config BLUSYS_LCD_ST7735_SCLK_PIN
        int "SCLK GPIO pin"
        default 18 if IDF_TARGET_ESP32
        default 4 if IDF_TARGET_ESP32C3
        default 12 if IDF_TARGET_ESP32S3

    config BLUSYS_LCD_ST7735_MOSI_PIN
        int "MOSI GPIO pin"
        default 23 if IDF_TARGET_ESP32
        default 6 if IDF_TARGET_ESP32C3
        default 11 if IDF_TARGET_ESP32S3

    config BLUSYS_LCD_ST7735_CS_PIN
        int "CS GPIO pin"
        default 5 if IDF_TARGET_ESP32
        default 7 if IDF_TARGET_ESP32C3
        default 10 if IDF_TARGET_ESP32S3

    config BLUSYS_LCD_ST7735_DC_PIN
        int "DC GPIO pin"
        default 2 if IDF_TARGET_ESP32
        default 3 if IDF_TARGET_ESP32C3
        default 13 if IDF_TARGET_ESP32S3

    config BLUSYS_LCD_ST7735_RST_PIN
        int "RST GPIO pin (-1 if not used)"
        default -1

    config BLUSYS_LCD_ST7735_BL_PIN
        int "Backlight GPIO pin (-1 if not used)"
        default -1

    config BLUSYS_LCD_ST7735_PCLK_HZ
        int "SPI pixel clock Hz"
        default 16000000

    config BLUSYS_LCD_ST7735_X_OFFSET
        int "ST7735 X offset"
        default 2

    config BLUSYS_LCD_ST7735_Y_OFFSET
        int "ST7735 Y offset"
        default 1

    config BLUSYS_LCD_ST7735_SWAP_XY
        bool "Swap X/Y"
        default y

    config BLUSYS_LCD_ST7735_MIRROR_X
        bool "Mirror X"
        default y

    config BLUSYS_LCD_ST7735_MIRROR_Y
        bool "Mirror Y"
        default n

    config BLUSYS_LCD_ST7735_INVERT_COLOR
        bool "Invert colors"
        default n

    endmenu
endmenu

menu "ui_basic"
    depends on CONFIG_DISPLAY_UI_SCENARIO_UI_BASIC
    menu "Blusys UI Basic Example"

        config BLUSYS_UI_SPI_BUS
            int "SPI bus"
            range 0 1
            default 0

        config BLUSYS_UI_SCLK_PIN
            int "SCLK GPIO pin"
            default 18 if IDF_TARGET_ESP32
            default 4 if IDF_TARGET_ESP32C3
            default 12 if IDF_TARGET_ESP32S3

        config BLUSYS_UI_MOSI_PIN
            int "MOSI GPIO pin"
            default 23 if IDF_TARGET_ESP32
            default 6 if IDF_TARGET_ESP32C3
            default 11 if IDF_TARGET_ESP32S3

        config BLUSYS_UI_CS_PIN
            int "CS GPIO pin"
            default 5 if IDF_TARGET_ESP32
            default 7 if IDF_TARGET_ESP32C3
            default 10 if IDF_TARGET_ESP32S3

        config BLUSYS_UI_DC_PIN
            int "DC GPIO pin"
            default 2 if IDF_TARGET_ESP32
            default 3 if IDF_TARGET_ESP32C3
            default 13 if IDF_TARGET_ESP32S3

        config BLUSYS_UI_RST_PIN
            int "RST GPIO pin (-1 if not used)"
            default -1

        config BLUSYS_UI_BL_PIN
            int "Backlight GPIO pin (-1 if not used)"
            default -1

        config BLUSYS_UI_PCLK_HZ
            int "SPI pixel clock Hz"
            default 8000000

        config BLUSYS_UI_BUF_LINES
            int "LVGL partial buffer lines"
            range 1 128
            default 20

        config BLUSYS_UI_FULL_REFRESH
            bool "Use experimental full-screen LVGL render buffer"
            default n

        config BLUSYS_UI_X_OFFSET
            int "ST7735 X offset"
            default 0

        config BLUSYS_UI_Y_OFFSET
            int "ST7735 Y offset"
            default 0

        config BLUSYS_UI_SWAP_XY
            bool "Swap X/Y"
            default y

        config BLUSYS_UI_MIRROR_X
            bool "Mirror X"
            default y

        config BLUSYS_UI_MIRROR_Y
            bool "Mirror Y"
            default n

        config BLUSYS_UI_INVERT_COLOR
            bool "Invert colors"
            default n

        choice BLUSYS_UI_SCENE
            prompt "UI scene"
            default BLUSYS_UI_SCENE_FULL

            config BLUSYS_UI_SCENE_LABEL_ONLY
                bool "Label only"

            config BLUSYS_UI_SCENE_FRAME_ONLY
                bool "Frame only"

            config BLUSYS_UI_SCENE_FULL
                bool "Frame + label"

        endchoice

    endmenu
endmenu

menu "encoder_basic"
    depends on CONFIG_DISPLAY_UI_SCENARIO_ENCODER_BASIC
    menu "Blusys Encoder Basic Example"

        config BLUSYS_ENCODER_BASIC_CLK_PIN
            int "Encoder CLK (A) GPIO pin"
            range 0 48
            default 19 if IDF_TARGET_ESP32
            default 1 if IDF_TARGET_ESP32C3
            default 5 if IDF_TARGET_ESP32S3

        config BLUSYS_ENCODER_BASIC_DT_PIN
            int "Encoder DT (B) GPIO pin"
            range 0 48
            default 18 if IDF_TARGET_ESP32
            default 0 if IDF_TARGET_ESP32C3
            default 6 if IDF_TARGET_ESP32S3

        config BLUSYS_ENCODER_BASIC_SW_PIN
            int "Encoder SW (button) GPIO pin (-1 to disable)"
            range -1 48
            default 23 if IDF_TARGET_ESP32
            default -1 if IDF_TARGET_ESP32C3
            default 7 if IDF_TARGET_ESP32S3

    endmenu
endmenu
```

## examples/reference/gateway/main/Kconfig.projbuild
```kconfig
menu "Gateway Example"

    config WIFI_SSID
        string "WiFi SSID"
        default "myssid"
        help
            SSID of the AP to connect to.

    config WIFI_PASSWORD
        string "WiFi Password"
        default "mypassword"
        help
            Password of the AP. Leave empty for open networks.

endmenu

menu "Gateway (display)"

choice BLUSYS_GW_DISPLAY_PROFILE
    prompt "Local operator display profile"
    default BLUSYS_GW_DISPLAY_PROFILE_ILI9341
    help
        SPI TFT for the gateway local dashboard. Defaults to ILI9341; ILI9488
        for large operator surfaces.

config BLUSYS_GW_DISPLAY_PROFILE_ILI9341
    bool "ILI9341 320x240 landscape"

config BLUSYS_GW_DISPLAY_PROFILE_ILI9488
    bool "ILI9488 480x320 landscape"

endchoice

endmenu
```

## examples/reference/gpio_basic/main/Kconfig.projbuild
```kconfig
menu "Blusys GPIO Basic Example"

config BLUSYS_GPIO_BASIC_OUTPUT_PIN
    int "Output GPIO pin"
    range 0 48
    default 4 if IDF_TARGET_ESP32
    default 3 if IDF_TARGET_ESP32C3
    default 4 if IDF_TARGET_ESP32S3
    help
        Select a board-safe output-capable GPIO for this example.

config BLUSYS_GPIO_BASIC_INPUT_PIN
    int "Input GPIO pin"
    range 0 48
    default 16 if IDF_TARGET_ESP32
    default 2 if IDF_TARGET_ESP32C3
    default 5 if IDF_TARGET_ESP32S3
    help
        Select a board-safe input-capable GPIO for this example.

endmenu
```
